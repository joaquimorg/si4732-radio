#define FFT_SPEED_OVER_PRECISION

#include <Arduino.h>
#include <arduinoFFT.h>
#include <Wire.h>
#include "EEPROM.h"
#include <SI4735.h>
#include "avdweb_Switch.h"
#include <ESP32RotaryEncoder.h>
#include "global.h"
#include "ui.h"
#include "presets.h"              // Usual frequencies and stations (generated by tools/gen_presets.py)
#include "rx_profiles.h"          // Receiver profiles (RX Mode) and AVC steps
#include "patch_full.h"          // SSB patch for whole SSBRX initialization string


UI ui;
// Encoder push button is handled by interrupt so presses are never missed while
// loop() is busy (audio sampling + FFT + display refresh take tens of ms).
// The ISR only latches the start of a press; loop() then tracks the release to tell
// short presses from long presses.
#define BUTTON_DEBOUNCE_MS 250
#define BUTTON_MIN_PRESS_MS  50   // Ignore releases seen while the contact is still bouncing
#define BUTTON_LONG_PRESS_MS 800
volatile bool buttonDown = false;
volatile uint32_t buttonDownTime = 0;
volatile uint32_t lastButtonIrq = 0;
bool longPressHandled = false;

void IRAM_ATTR buttonISR() {
	uint32_t now = millis();
	if (!buttonDown && now - lastButtonIrq > BUTTON_DEBOUNCE_MS) {
		buttonDown = true;
		buttonDownTime = now;
	}
	lastButtonIrq = now;
}
RotaryEncoder encoder = RotaryEncoder(ROTARY_ENCODER_A_PIN, ROTARY_ENCODER_B_PIN, RE_DEFAULT_PIN, ROTARY_ENCODER_VCC_PIN);
SI4735 rx;

// SI473/5 and UI
#define MIN_ELAPSED_TIME         5  // 300
#define MIN_ELAPSED_RSSI_TIME  500  // RSSI check uses IN_ELAPSED_RSSI_TIME * 6 = 1.2s
#define ELAPSED_COMMAND      10000  // time to turn off the last command controlled by encoder. Time to goes back to the VFO control // G8PTN: Increased time and corrected comment
#define ELAPSED_CLICK         1000  // time to check the double click commands
#define DEFAULT_VOLUME          35  // change it for your favorite sound volume
#define RDS_CHECK_TIME         500  // Increased from 90

#define BACKGROUND_REFRESH_TIME 100    // Background screen refresh time. Covers the situation where there are no other events causing a refresh

// SI4732/5 patch
const uint16_t size_content = sizeof ssb_patch_content; // see patch_init.h

#define EEPROM_SIZE     512
#define STORE_TIME    10000                  // Time of inactivity to make the current receiver status writable (10s)

// EEPROM 
// ====================================================================================================================================================
// Update F/W version comment as required   F/W VER    Function                                                           Locn (dec)            Bytes
// ====================================================================================================================================================
const uint8_t  app_id = 65;          //               EEPROM ID.  If EEPROM read value mismatch, reset EEPROM            eeprom_address        1
const uint16_t app_ver = 101;         //     v1.01     EEPROM VER. If EEPROM read value mismatch (older), reset EEPROM    eeprom_ver_address    2
const int eeprom_address = 0;         //               EEPROM start address
const int eeprom_set_address = 256;   //               EEPROM setting base adddress
const int eeprom_setp_address = 272;  //               EEPROM setting (per band) base adddress
const int eeprom_ver_address = 496;   //               EEPROM version base adddress

long storeTime = millis();
bool itIsTimeToSave = false;

bool infoShow = false;
char infoMessage[40];

bool bfoOn = false;
bool ssbLoaded = false;

bool muted = false;
int8_t agcIdx = 0;
uint8_t disableAgc = 0;
int8_t agcNdx = 0;
int8_t softMuteMaxAttIdx = 4;
uint8_t countClick = 0;

uint8_t seekDirection = 1;
bool seekStop = false;        // G8PTN: Added flag to abort seeking on rotary encoder detection

bool cmdBand = false;
bool cmdVolume = false;
bool cmdAgc = false;
bool cmdBandwidth = false;
bool cmdStep = false;
bool cmdMode = false;
bool cmdMenu = false;
bool cmdSoftMuteMaxAtt = false;
bool cmdCal = false;
bool cmdAvc = false;
bool cmdRxMode = false;

// Presets menu: band (group) -> type -> station
bool cmdPresetGroup = false;
bool cmdPresetType = false;
bool cmdPresetStation = false;

// Frequency direct edit (long press)
bool cmdFreqEdit = false;
uint16_t editFrequency = 0;             // FM: 10 kHz units, AM/SSB: kHz
uint8_t editDigit = 0;                  // Power of ten being edited (0 = least significant)
uint8_t editNumDigits = 0;              // Number of editable digits for the current band

bool fmRDS = false;

int16_t currentBFO = 0;
long elapsedRSSI = millis();
long elapsedButton = millis();

long lastStrengthCheck = millis();
long lastRDSCheck = millis();

long elapsedClick = millis();
long elapsedCommand = millis();
volatile int encoderCount = 0;
uint16_t currentFrequency;

const uint16_t currentBFOStep = 10;

// G8PTN: Main additional variables
// BFO and Calibration limits (BFOMax + CALMax <= 16000)
const int BFOMax = 14000;               // Maximum range for currentBFO = +/- BFOMax
const int CALMax = 2000;               // Maximum range for currentCAL = +/- CALMax

// AGC/ATTN index per mode (FM/AM/SSB)
int8_t FmAgcIdx = 0;                    // Default FM  AGGON  : Range = 0 to 37, 0 = AGCON, 1 - 27 = ATTN 0 to 26 
int8_t AmAgcIdx = 0;                    // Default AM  AGCON  : Range = 0 to 37, 0 = AGCON, 1 - 37 = ATTN 0 to 36
int8_t SsbAgcIdx = 0;                   // Default SSB AGCON  : Range = 0 to 37, 0 = AGCON, 1 - 37 = ATTN 0 to 36

// AVC index per mode (AM/SSB)
int8_t AmAvcIdx = 36;                   // Default AM  = 36, range = 12 to 90, menu steps in rxAvcSteps[]
int8_t SsbAvcIdx = 36;                  // Default SSB = 36, range = 12 to 90, menu steps in rxAvcSteps[]

// SoftMute index per mode (AM/SSB)
int8_t AmSoftMuteIdx = 4;               // Default AM  = 4, range = 0 to 32
int8_t SsbSoftMuteIdx = 0;              // Default SSB = 0, range = 0 to 32

// Status bar icon flags
bool eeprom_wr_flag = false;            // Flag indicating EEPROM write request

// Firmware controlled mute
uint8_t mute_vol_val = 0;               // Volume level when mute is applied

// Menu options
int16_t currentCAL = 0;                 // Calibration offset, +/- 1000Hz in steps of 10Hz
uint16_t currentBrt = 128;              // Display brightness, range = 32 to 255 in steps of 32
int8_t currentAVC = 48;                 // Selected AVC, range = 12 to 90 in steps of 2

// Background screen refresh
uint32_t background_timer = millis();   // Background screen refresh timer.
uint32_t tuning_timer = millis();       // Tuning hold off timer.
bool tuning_flag = false;               // Flag to indicate tuning

// Bandwidth data structure
typedef struct
{
	uint8_t idx;      // SI473X device bandwidth index
	const char* desc; // bandwidth description
} Bandwidth;

int8_t bwIdxSSB = 4;
const int8_t maxSsbBw = 5;
Bandwidth bandwidthSSB[] = {
  {4, ""},
  {5, ""},
  {0, ""},
  {1, ""},
  {2, ""},
  {3, ""}
};
const int lastBandwidthSSB = (sizeof bandwidthSSB / sizeof(Bandwidth)) - 1;

int8_t bwIdxAM = 4;
const int8_t maxAmBw = 6;
Bandwidth bandwidthAM[] = {
  {4, ""},
  {5, ""},
  {3, ""},
  {6, ""},
  {2, ""},
  {1, ""},
  {0, ""}
};
const int lastBandwidthAM = (sizeof bandwidthAM / sizeof(Bandwidth)) - 1;

int8_t bwIdxFM = 0;
const int8_t maxFmBw = 4;
Bandwidth bandwidthFM[] = {
	{0, ""}, // Automatic - default
	{1, ""}, // Force wide (110 kHz) channel filter.
	{2, ""},
	{3, ""},
	{4, ""} };
const int lastBandwidthFM = (sizeof bandwidthFM / sizeof(Bandwidth)) - 1;


static constexpr const char* bandwidthSSBStr = "0.5 kHz\n1.0 kHz\n1.2 kHz\n2.2 kHz\n3.0 kHz\n4.0 kHz";
static constexpr const char* bandwidthAMStr = "1.0 kHz\n1.8 kHz\n2.0 kHz\n2.5 kHz\n3.0 kHz\n4.0 kHz\n6.0 kHz";
static constexpr const char* bandwidthFMStr = "AUTO\n110 kHz\n 84 kHz\n 60 kHz\n 40 kHz";


int tabAmStep[] = { 1,      // 0   AM/SSB   (kHz)
				   5,      // 1   AM/SSB   (kHz)
				   9,      // 2   AM/SSB   (kHz)
				   10,     // 3   AM/SSB   (kHz)
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				   100,    // 10  SSB      (Hz)
				   500 };   // 11  SSB      (Hz)

uint8_t AmTotalSteps = 7;                          // Total AM steps
uint8_t AmTotalStepsSsb = 4;                       // G8PTN: Original : AM(LW/MW) 1k, 5k, 9k, 10k, 50k        : SSB 1k, 5k, 9k, 10k
//uint8_t AmTotalStepsSsb = 5;                     // G8PTN: Option 1 : AM(LW/MW) 1k, 5k, 9k, 10k, 100k       : SSB 1k, 5k, 9k, 10k, 50k
//uint8_t AmTotalStepsSsb = 6;                     // G8PTN: Option 2 : AM(LW/MW) 1k, 5k, 9k, 10k, 100k , 1M  : SSB 1k, 5k, 9k, 10k, 50k, 100k
//uint8_t AmTotalStepsSsb = 7;                     // G8PTN: Invalid option (Do not use)
uint8_t SsbTotalSteps = 5;                         // SSB sub 1kHz steps 
volatile int8_t idxAmStep = 3;

const char* AmSsbStepStr = "1 kHz\n5 kHz\n9 kHz\n10 kHz\n50 kHz\n100 kHz\n1 MHz\n10 Hz\n25 Hz\n50 Hz\n100 Hz\n500 Hz";
const char* AmStepStr = "1 kHz\n5 kHz\n9 kHz\n10 kHz\n50 kHz\n100 kHz\n1 MHz";

int tabFmStep[] = { 5, 10, 20, 100 };                             // G8PTN: Added 1MHz step
const int lastFmStep = (sizeof tabFmStep / sizeof(int)) - 1;
int idxFmStep = 1;

const char* FmStepStr = "50 kHz\n100 kHz\n200 kHz\n1 MHz";


uint16_t currentStepIdx = 1;

uint8_t currentMode = FM;

const char* modeStr = "FM\nLSB\nUSB\nAM\nCW";

const char* getStr(const char* str, int idx) {
	return getStrValue(str, idx);
};

/**
 *  Band data structure
 */
typedef struct
{
	const char* bandName;   // Band description
	uint8_t 	bandType;   // Band type (FM, MW or SW)
	uint8_t 	bandMODE; 	// Pref. modulation
	uint16_t minimumFreq;   // Minimum frequency of the band
	uint16_t maximumFreq;   // maximum frequency of the band
	uint16_t currentFreq;   // Default frequency or current frequency
	int8_t currentStepIdx;  // Idex of tabStepAM:  Defeult frequency step (See tabStepAM)
	int8_t bandwidthIdx;    // Index of the table bandwidthFM, bandwidthAM or bandwidthSSB;
	int16_t bandCAL;        // Calibration offset, +/- 1000Hz in steps of 10Hz
} Band;

/*
   Band table
   YOU CAN CONFIGURE YOUR OWN BAND PLAN. Be guided by the comments.
   To add a new band, all you have to do is insert a new line in the table below. No extra code will be needed.
   You can remove a band by deleting a line if you do not want a given band.
   Also, you can change the parameters of the band.
   ATTENTION: You have to RESET the eeprom after adding or removing a line of this table.
			  Turn your receiver on with the encoder push button pressed at first time to RESET the eeprom content.
*/

Band band[] = {
	{  "FM" 		, FM_BAND_TYPE,  FM,  8750, 10800,  9740,  1, 0, 0}, // FM        
	{  "LW" 		, LW_BAND_TYPE,  AM,   130,   279,   198,  0, 4, 0}, // LW        
	{  "AM" 		, MW_BAND_TYPE,  AM,   522,  1701,  1395,  0, 4, 0}, // AM        
	{  "Whole SW"	, SW_BAND_TYPE,  AM,  1730, 30000, 15500,  0, 4, 0}, // Whole SW  
	{  "Ham 600M"	, LW_BAND_TYPE,  AM,   280,   470,   284,  0, 4, 0}, // Ham  600M 
	{  "Ham 630M" 	, SW_BAND_TYPE, LSB,   472,   479,   475,  0, 4, 0}, // Ham  630M 
	{  "Ham 160M" 	, SW_BAND_TYPE, LSB,  1800,  1910,  1899,  0, 4, 0}, // Ham  160M 
	{  "Ham 80M" 	, SW_BAND_TYPE, LSB,  3500,  3800,  3630,  0, 4, 0}, // Ham   80M 
	{  "Ham 60M" 	, SW_BAND_TYPE, USB,  5330,  5410,  5375,  0, 4, 0}, // Ham   60M 
	{  "Ham 40M" 	, SW_BAND_TYPE, LSB,  7000,  7200,  7185,  0, 4, 0}, // Ham   40M 
	{  "Ham 30M" 	, SW_BAND_TYPE, USB, 10100, 10150, 10125,  0, 4, 0}, // Ham   30M 
	{  "Ham 20M" 	, SW_BAND_TYPE, USB, 14000, 14350, 14250,  0, 4, 0}, // Ham   20M 
	{  "Ham 17M" 	, SW_BAND_TYPE, USB, 18068, 18168, 18100,  0, 4, 0}, // Ham   17M 
	{  "Ham 15M" 	, SW_BAND_TYPE, USB, 21000, 21450, 21350,  0, 4, 0}, // Ham   15M 
	{  "Ham 12M" 	, SW_BAND_TYPE, USB, 24890, 24990, 24940,  0, 4, 0}, // Ham   12M 	
	{  "Ham 10M"	, SW_BAND_TYPE, USB, 28000, 30000, 28500,  0, 4, 0}, // Ham   10M 
	{  "CB" 		, SW_BAND_TYPE,  AM, 26200, 27990, 27200,  0, 4, 0}, // CB band
	{  "120M" 		, SW_BAND_TYPE,  AM,  2300,  2495,  2400,  0, 4, 0}, //      120M 
	{  "90M" 		, SW_BAND_TYPE,  AM,  3200,  3400,  3300,  0, 4, 0}, //       90M 
	{  "75M" 		, SW_BAND_TYPE,  AM,  3900,  4000,  3950,  0, 4, 0}, //       75M 
	{  "49M" 		, SW_BAND_TYPE,  AM,  5900,  6200,  6000,  0, 4, 0}, //       49M 
	{  "41M" 		, SW_BAND_TYPE,  AM,  7200,  7450,  7210,  0, 4, 0}, //       41M 
	{  "31M" 		, SW_BAND_TYPE,  AM,  9400,  9900,  9600,  0, 4, 0}, //       31M 
	{  "25M" 		, SW_BAND_TYPE,  AM, 11600, 12100, 11700,  0, 4, 0}, //       25M 
	{  "22M" 		, SW_BAND_TYPE,  AM, 13570, 13870, 13700,  0, 4, 0}, //       22M 
	{  "19M" 		, SW_BAND_TYPE,  AM, 15100, 15830, 15700,  0, 4, 0}, //       19M 
	{  "16M" 		, SW_BAND_TYPE,  AM, 17480, 17900, 17600,  0, 4, 0}, //       16M 
	{  "15M" 		, SW_BAND_TYPE,  AM, 18900, 19020, 18950,  0, 4, 0}, //       15M 
	{  "13M" 		, SW_BAND_TYPE,  AM, 21450, 21850, 21500,  0, 4, 0}, //       13M 
	{  "11M" 		, SW_BAND_TYPE,  AM, 25670, 26100, 25800,  0, 4, 0}  //       11M 	   

};

const int lastBand = (sizeof band / sizeof(Band)) - 1;
int bandIdx = 0;

const char* bandStr = "FM\nLW\nAM\nWhole SW\nHam 600M\nHam 630M\nHam 160M\nHam 80M\nHam 60M\nHam 40M\nHam 30M\nHam 20M\nHam 17M\nHam 15M\nHam 12M\nHam 10M\nCB\n120M\n90M\n75M\n49M\n41M\n31M\n25M\n22M\n19M\n16M\n15M\n13M\n11M";

/*
   IARU Region 1 HF band plan (simplified), shown on the band ruler.
   The segment under the tuned frequency is named next to the band name.
*/
const BandSegment bandPlan[] = {
	{  1810,  1838, SEG_CW,    "CW"   }, {  1838,  1843, SEG_DIGI,  "DIGI" }, {  1843,  2000, SEG_PHONE, "SSB"  },
	{  3500,  3570, SEG_CW,    "CW"   }, {  3570,  3600, SEG_DIGI,  "DIGI" }, {  3600,  3800, SEG_PHONE, "SSB"  },
	{  5351,  5354, SEG_CW,    "CW"   }, {  5354,  5367, SEG_PHONE, "SSB"  },
	{  7000,  7040, SEG_CW,    "CW"   }, {  7040,  7060, SEG_DIGI,  "DIGI" }, {  7060,  7200, SEG_PHONE, "SSB"  },
	{ 10100, 10130, SEG_CW,    "CW"   }, { 10130, 10150, SEG_DIGI,  "DIGI" },
	{ 14000, 14070, SEG_CW,    "CW"   }, { 14070, 14101, SEG_DIGI,  "DIGI" }, { 14101, 14350, SEG_PHONE, "SSB"  },
	{ 18068, 18095, SEG_CW,    "CW"   }, { 18095, 18111, SEG_DIGI,  "DIGI" }, { 18111, 18168, SEG_PHONE, "SSB"  },
	{ 21000, 21070, SEG_CW,    "CW"   }, { 21070, 21151, SEG_DIGI,  "DIGI" }, { 21151, 21450, SEG_PHONE, "SSB"  },
	{ 24890, 24915, SEG_CW,    "CW"   }, { 24915, 24931, SEG_DIGI,  "DIGI" }, { 24931, 24990, SEG_PHONE, "SSB"  },
	{ 28000, 28070, SEG_CW,    "CW"   }, { 28070, 28225, SEG_DIGI,  "DIGI" }, { 28225, 29200, SEG_PHONE, "SSB"  },
	{ 29200, 29300, SEG_DIGI,  "DIGI" }, { 29300, 29510, SEG_OTHER, "SAT"  }, { 29510, 29700, SEG_OTHER, "FM"   }
};
const uint8_t bandPlanCount = sizeof(bandPlan) / sizeof(BandSegment);



//int tabStep[] = {1, 5, 10, 50, 100, 500, 1000};
//const int lastStep = (sizeof tabStep / sizeof(int)) - 1;


// Calibration (per band). Size needs to be the same as band[]
// Defaults
//int16_t bandCAL[] = { 0, 0, 0, 0, 0, 0, 0, 0, 0, 0, 0, 0, 0, 0, 0, 0, 0, 0, 0, 0, 0, 0, 0, 0, 0, 0, 0, 0, 0, 0 };

// Mode (per band). Size needs to be the same as band[] and mode needs to be appropriate for bandType
// Example bandType = FM_BAND_TYPE, bandMODE = FM. All other BAND_TYPE's, bandMODE = AM/LSB/USB
// Defaults
//uint8_t bandMODE[] = { FM, AM, AM, AM, LSB, AM, AM, LSB, AM, AM, AM, AM, USB, AM, AM, USB, AM, AM, USB, AM };

char* rdsMsg;
char* stationName;
char* rdsTime;

uint8_t rssi = 0;
uint8_t snr = 0;
uint8_t volume = DEFAULT_VOLUME;

// Menu Options
#define STEP         0
#define BAND         1
#define PRESETS      2
#define MODE         3
#define RXMODE       4
#define VOLUME       5
#define BW           6
#define MUTE         7
#define AGC_ATT      8
#define SOFTMUTE     9
#define AVC         10
#define SEEKUP      11
#define SEEKDOWN    12
#define CALIBRATION 13
#define DECODECW 	14
#define SPECTRUM 	15
#define EXIT 		16

const char* MenuStr = "Step\nBand\nPresets\nMode\nRX Mode\nVolume\nBandwidth\nMute\nAGC/ATTN\nSoftMute\nAVC\nSeek UP\nSeek DOWN\nCalibration\nDecode CW\nSpectrum\nExit";

bool spectrumOn = true;                 // Spectrum/waterfall display. Off = no audio sampling, FFT or display traffic for it

int8_t currentMenuCmd = -1;
int8_t menuIdx = STEP;


/* ---------------------------------------- */
#define SAMPLES         256          // Must be a power of 2
#define SAMPLING_FREQ   8000        // Hz, must be 40000 or less due to ADC conversion time. Determines maximum frequency that can be analysed by the FFT Fmax=sampleF/2.
#define AMPLITUDE       100          // Depending on your audio source level, you may need to alter this value. Can be used as a 'sensitivity' control.
#define NOISE           1000         // Used as a crude noise filter, values below this are ignored
#define NUM_BANDS       SAMPLES / 2  // To change this, you will need to change the bunch of if statements describing the mapping from bins to bands

// Sampling and FFT stuff
unsigned int sampling_period_us;
int bandValues[NUM_BANDS] = { 0 };
float peak = 0;
uint16_t vu = 0;
int oldBarHeights[NUM_BANDS] = { 0 };
float vReal[SAMPLES];
float vImag[SAMPLES];
unsigned long newTime;

#define NUM_WATERFALL_ROWS 35
int waterfallData[NUM_WATERFALL_ROWS][NUM_BANDS] = { 0 };

ArduinoFFT<float> FFT = ArduinoFFT<float>(vReal, vImag, SAMPLES, SAMPLING_FREQ);

/* ---------------------------------------- */

bool decodeCW = false; // Flag to indicate if CW decoding is enabled
bool isCW = false;
// Morse code settings
#define FREQ_MIN 500           // Minimum frequency of interest (Hz)
#define FREQ_MAX 900           // Maximum frequency of interest (Hz)
#define SIGNAL_THRESHOLD 10000   // Threshold for detecting a signal
#define DOT_DURATION 80        // Typical dot duration in milliseconds
#define DASH_DURATION 240      // Typical dash duration in milliseconds (3x dot)
#define ELEMENT_GAP 80         // Gap between elements (dots/dashes) in ms
#define LETTER_GAP 240         // Gap between letters in ms (3x element gap)
#define WORD_GAP 560           // Gap between words in ms (7x element gap)

// Buffer for decoded characters
const int MAX_BUFFER = 40;
char morseBuffer[7] = { 0 };  // Holds dots and dashes of current character
int morseIndex = 0;
char textBuffer[MAX_BUFFER] = { 0 };
int textIndex = 0;

// Timing variables
unsigned long signalStart = 0;
unsigned long signalEnd = 0;
unsigned long silenceStart = 0;
//bool signalDetected = false;
bool wasSignalDetected = false;

// Morse code lookup table
const char* morseTable[] = {
  ".-",    // A
  "-...",  // B
  "-.-.",  // C
  "-..",   // D
  ".",     // E
  "..-.",  // F
  "--.",   // G
  "....",  // H
  "..",    // I
  ".---",  // J
  "-.-",   // K
  ".-..",  // L
  "--",    // M
  "-.",    // N
  "---",   // O
  ".--.",  // P
  "--.-",  // Q
  ".-.",   // R
  "...",   // S
  "-",     // T
  "..-",   // U
  "...-",  // V
  ".--",   // W
  "-..-",  // X
  "-.--",  // Y
  "--..",  // Z
  "-----", // 0
  ".----", // 1
  "..---", // 2
  "...--", // 3
  "....-", // 4
  ".....", // 5
  "-....", // 6
  "--...", // 7
  "---..", // 8
  "----."  // 9
};

char morseToChar() {
	morseBuffer[morseIndex] = '\0'; // Null-terminate

	// Check letters
	for (int i = 0; i < 26; i++) {
		if (strcmp(morseBuffer, morseTable[i]) == 0) {
			return 'A' + i;
		}
	}

	// Check numbers
	for (int i = 0; i < 10; i++) {
		if (strcmp(morseBuffer, morseTable[i + 26]) == 0) {
			return '0' + i;
		}
	}

	// Special characters
	if (strcmp(morseBuffer, ".-.-.-") == 0) return '.';
	if (strcmp(morseBuffer, "--..--") == 0) return ',';
	if (strcmp(morseBuffer, "..--..") == 0) return '?';
	if (strcmp(morseBuffer, "-..-.") == 0) return '/';

	return '?'; // Unknown symbol
}

void addToTextBuffer(char c) {
	if (textIndex < MAX_BUFFER - 1) {
		textBuffer[textIndex++] = c;
		textBuffer[textIndex] = '\0';
	}
	else {
		// Buffer full, shift everything left
		for (int i = 0; i < MAX_BUFFER - 2; i++) {
			textBuffer[i] = textBuffer[i + 1];
		}
		textBuffer[MAX_BUFFER - 2] = c;
		textBuffer[MAX_BUFFER - 1] = '\0';
	}
}

void processMorseElement(unsigned long duration) {
	if (duration < (DOT_DURATION + DASH_DURATION) / 2) {
		// It's a dot
		if (morseIndex < 6) {
			morseBuffer[morseIndex++] = '.';
			morseBuffer[morseIndex] = '\0';
		}
		//Serial.print(".");
	}
	else {
		// It's a dash
		if (morseIndex < 6) {
			morseBuffer[morseIndex++] = '-';
			morseBuffer[morseIndex] = '\0';
		}
		//Serial.print("-");
	}
	//updateDisplay();
}

void processSilence(unsigned long duration) {
	if (duration >= LETTER_GAP && duration < WORD_GAP) {
		// End of letter
		if (morseIndex > 0) {
			char decoded = morseToChar();
			addToTextBuffer(decoded);
			//Serial.print(" [");
			//Serial.print(decoded);
			//Serial.println("]");

			// Reset morse buffer
			morseIndex = 0;
			morseBuffer[0] = '\0';
			//updateDisplay();
		}
	}
	else if (duration >= WORD_GAP) {
		// End of word
		if (morseIndex > 0) {
			// Process any pending character
			char decoded = morseToChar();
			addToTextBuffer(decoded);
			//Serial.print(" [");
			//Serial.print(decoded);
			//Serial.println("]");

			// Reset morse buffer
			morseIndex = 0;
			morseBuffer[0] = '\0';
		}

		// Add space between words
		addToTextBuffer(' ');
		//Serial.println(" [SPACE]");
		//updateDisplay();
	}
}

/* ---------------------------------------- */


void doSoftMute(int8_t v);
void doAgc(int8_t v);
void updateBFO();
void useBand();
void loadSSB();
void doAvc(int16_t v);
void selectMenuList(int8_t v);
uint8_t getStrength();
void tuneEditFrequency();
void drawBottomPanel();
const char* mainMenuValue(uint8_t idx);
bool isMenuMode();
extern int8_t bwIdxBeforeCW;


/* ---------------------------------------- */

// SSB Mode detection
bool isSSB()
{
	return currentMode == LSB || currentMode == USB || currentMode == CW;   // CW uses the SSB patch
}

// Sideband passed to the SI4732: CW is received as USB
uint8_t getSsbSideband()
{
	return (currentMode == CW) ? USB : currentMode;
}

/* ---------------------------------------- */
/* Receiver settings writer: the only place that sends AGC/ATTN, AVC, SoftMute and the AM/SSB filters */
/* to the SI4732. It remembers what was last written, so a setting that did not change costs no I2C   */
/* traffic. Powering the chip up again (setAM/setSSB/setFM, SSB patch) resets those settings to the   */
/* chip defaults, so useBand() and loadSSB() call rxInvalidate() and then write everything again.     */

struct RxApplied {
	int16_t agc;                            // (AGCDIS << 8) | AGCIDX
	int16_t avc;
	int16_t softMute;
	int16_t amFilter;
	int16_t ssbMode;                        // (AUDIOBW << 8) | SBCUTFLT
};
RxApplied rxApplied = { -1, -1, -1, -1, -1 };

void rxInvalidate()
{
	rxApplied = { -1, -1, -1, -1, -1 };
}

void rxWriteAgc(uint8_t agcDisabled, uint8_t agcIndex)
{
	int16_t v = (agcDisabled << 8) | agcIndex;
	if (v == rxApplied.agc) return;
	rx.setAutomaticGainControl(agcDisabled, agcIndex);    // FM_AGC_OVERRIDE in FM, AM/SSB_AGC_OVERRIDE (0x48) otherwise
	rxApplied.agc = v;
}

void rxWriteAvc(uint8_t maxGain)
{
	if (maxGain == rxApplied.avc) return;
	rx.setAvcAmMaxGain(maxGain);                          // AM_AUTOMATIC_VOLUME_CONTROL_MAX_GAIN, also used by the SSB patch
	rxApplied.avc = maxGain;
}

void rxWriteSoftMute(uint8_t maxAttenuation)
{
	if (maxAttenuation == rxApplied.softMute) return;
	rx.setAmSoftMuteMaxAttenuation(maxAttenuation);       // Property 0x3302 = AM and SSB_SOFT_MUTE_MAX_ATTENUATION
	rxApplied.softMute = maxAttenuation;
}

void rxWriteAmFilter(uint8_t amchflt)
{
	if (amchflt == rxApplied.amFilter) return;
	rx.setBandwidth(amchflt, 1);                          // AMPLFLT = 1: power line noise rejection filter on
	rxApplied.amFilter = amchflt;
}

// SSB_MODE property in a single write. AN332: with an audio bandwidth of about 2 kHz or less (1.2 kHz and
// the 0.5 / 1 kHz CW band-pass filters) use the sideband band-pass filter (SBCUTFLT = 0) for a sharper
// high cut; with 2.2 kHz and wider use the low-pass filter (SBCUTFLT = 1), the band-pass filter would cut
// the wanted sideband at 2 kHz. AVC enabled, SSB (not SYNC) mode, DSP AFC disabled.
void rxWriteSsbMode(uint8_t audiobw)
{
	uint8_t sbcutflt = (audiobw == 0 || audiobw == 4 || audiobw == 5) ? 0 : 1;
	int16_t v = (audiobw << 8) | sbcutflt;
	if (v == rxApplied.ssbMode) return;
	rx.setSSBConfig(audiobw, sbcutflt, 0 /*AVC_DIVIDER*/, 1 /*AVCEN*/, 0 /*SMUTESEL: RSSI*/, 1 /*DSP_AFCDIS*/);
	rxApplied.ssbMode = v;
}

// SSB audio bandwidth (bwIdxSSB) with its sideband cutoff filter
void applySsbBandwidth()
{
	rxWriteSsbMode(bandwidthSSB[bwIdxSSB].idx);
}


// Generation of step value
int getSteps()
{
	if (isSSB())
	{
		if (idxAmStep >= AmTotalSteps)
			return tabAmStep[idxAmStep];            // SSB: Return in Hz used for VFO + BFO tuning

		return tabAmStep[idxAmStep] * 1000;         // SSB: Return in Hz used for VFO + BFO tuning
	}

	if (idxAmStep >= AmTotalSteps)                  // AM: Set to 0kHz if step is from the SSB Hz values 
		idxAmStep = 0;

	return tabAmStep[idxAmStep];                    // AM: Return value in KHz for SI4732 step
}


// Generate last step index
int getLastStep()
{

	if (isSSB())
		return AmTotalSteps + SsbTotalSteps - 1;
	else if (bandIdx == LW_BAND_TYPE || bandIdx == MW_BAND_TYPE)    // G8PTN; Added in place of check in doStep() for LW/MW step limit
		return AmTotalStepsSsb;
	else
		return AmTotalSteps - 1;
}

// -----------------------------------------------------------------------------------

/*
   writes the conrrent receiver information into the eeprom.
   The EEPROM.update avoid write the same data in the same memory position. It will save unnecessary recording.
*/
void saveAllReceiverInformation()
{
	eeprom_wr_flag = true;
	int addr_offset;
	int16_t currentBFOs = (currentBFO % 1000);            // G8PTN: For SSB ensures BFO value is valid wrt band[bandIdx].currentFreq = currentFrequency;

	EEPROM.begin(EEPROM_SIZE);

	EEPROM.write(eeprom_address, app_id);                 // Stores the app id;
	EEPROM.write(eeprom_address + 1, rx.getVolume());     // Stores the current Volume
	EEPROM.write(eeprom_address + 2, bandIdx);            // Stores the current band
	EEPROM.write(eeprom_address + 3, fmRDS);              // G8PTN: Not used
	EEPROM.write(eeprom_address + 4, currentMode);        // Stores the current Mode (FM / AM / LSB / USB). Now per mode, leave for compatibility
	EEPROM.write(eeprom_address + 5, currentBFOs >> 8);   // G8PTN: Stores the current BFO % 1000 (HIGH byte)
	EEPROM.write(eeprom_address + 6, currentBFOs & 0XFF); // G8PTN: Stores the current BFO % 1000 (LOW byte)
	EEPROM.commit();

	addr_offset = 7;

	// G8PTN: Commented out the assignment
	// - The line appears to be required to ensure the band[bandIdx].currentFreq = currentFrequency
	// - Updated main code to ensure that this should occur as required with frequency, band or mode changes
	// - The EEPROM reset code now calls saveAllReceiverInformation(), which is the correct action, this line
	//   must be disabled otherwise band[bandIdx].currentFreq = 0 (where bandIdx = 0; by default) on EEPROM reset
	//band[bandIdx].currentFreq = currentFrequency;

	for (int i = 0; i <= lastBand; i++)
	{
		EEPROM.write(addr_offset++, (band[i].currentFreq >> 8));   // Stores the current Frequency HIGH byte for the band
		EEPROM.write(addr_offset++, (band[i].currentFreq & 0xFF)); // Stores the current Frequency LOW byte for the band
		EEPROM.write(addr_offset++, band[i].currentStepIdx);       // Stores current step of the band
		EEPROM.write(addr_offset++, band[i].bandwidthIdx);         // table index (direct position) of bandwidth
		EEPROM.commit();
	}

	// G8PTN: Added
	addr_offset = eeprom_set_address;
	EEPROM.write(addr_offset++, currentBrt >> 8);         // Stores the current Brightness value (HIGH byte)
	EEPROM.write(addr_offset++, currentBrt & 0XFF);       // Stores the current Brightness value (LOW byte)
	EEPROM.write(addr_offset++, FmAgcIdx);                // Stores the current FM AGC/ATTN index value
	EEPROM.write(addr_offset++, AmAgcIdx);                // Stores the current AM AGC/ATTN index value
	EEPROM.write(addr_offset++, SsbAgcIdx);               // Stores the current SSB AGC/ATTN index value
	EEPROM.write(addr_offset++, AmAvcIdx);                // Stores the current AM AVC index value
	EEPROM.write(addr_offset++, SsbAvcIdx);               // Stores the current SSB AVC index value
	EEPROM.write(addr_offset++, AmSoftMuteIdx);           // Stores the current AM SoftMute index value
	EEPROM.write(addr_offset++, SsbSoftMuteIdx);          // Stores the current SSB SoftMute index value
	EEPROM.write(addr_offset++, spectrumOn);              // Stores the Spectrum display on/off
	EEPROM.commit();

	addr_offset = eeprom_setp_address;
	for (int i = 0; i <= lastBand; i++)
	{
		EEPROM.write(addr_offset++, (band[i].bandCAL >> 8));     // Stores the current Calibration value (HIGH byte) for the band
		EEPROM.write(addr_offset++, (band[i].bandCAL & 0XFF));   // Stores the current Calibration value (LOW byte) for the band
		EEPROM.write(addr_offset++, band[i].bandMODE);          // Stores the current Mode value for the band
		EEPROM.commit();
	}

	addr_offset = eeprom_ver_address;
	EEPROM.write(addr_offset++, app_ver >> 8);            // Stores app_ver (HIGH byte)
	EEPROM.write(addr_offset++, app_ver & 0XFF);          // Stores app_ver (LOW byte)
	EEPROM.commit();

	EEPROM.end();
}


/**
 * reads the last receiver status from eeprom.
 */
void readAllReceiverInformation()
{
	uint8_t volume;
	int addr_offset;
	int bwIdx;
	EEPROM.begin(EEPROM_SIZE);

	volume = EEPROM.read(eeprom_address + 1); // Gets the stored volume;
	bandIdx = EEPROM.read(eeprom_address + 2);
	fmRDS = EEPROM.read(eeprom_address + 3);                // G8PTN: Not used
	currentMode = EEPROM.read(eeprom_address + 4);          // G8PTM: Reads stored Mode. Now per mode, leave for compatibility
	currentBFO = EEPROM.read(eeprom_address + 5) << 8;      // G8PTN: Reads stored BFO value (HIGH byte)
	currentBFO |= EEPROM.read(eeprom_address + 6);          // G8PTN: Reads stored BFO value (HIGH byte)

	addr_offset = 7;
	for (int i = 0; i <= lastBand; i++)
	{
		band[i].currentFreq = EEPROM.read(addr_offset++) << 8;
		band[i].currentFreq |= EEPROM.read(addr_offset++);
		band[i].currentStepIdx = EEPROM.read(addr_offset++);
		band[i].bandwidthIdx = EEPROM.read(addr_offset++);
	}

	// G8PTN: Added
	addr_offset = eeprom_set_address;
	currentBrt = EEPROM.read(addr_offset++) << 8;      // Reads stored Brightness value (HIGH byte)
	currentBrt |= EEPROM.read(addr_offset++);           // Reads stored Brightness value (LOW byte)
	FmAgcIdx = EEPROM.read(addr_offset++);           // Reads stored FM AGC/ATTN index value
	AmAgcIdx = EEPROM.read(addr_offset++);           // Reads stored AM AGC/ATTN index value
	SsbAgcIdx = EEPROM.read(addr_offset++);           // Reads stored SSB AGC/ATTN index value
	AmAvcIdx = EEPROM.read(addr_offset++);           // Reads stored AM AVC index value
	SsbAvcIdx = EEPROM.read(addr_offset++);           // Reads stored SSB AVC index value
	AmSoftMuteIdx = EEPROM.read(addr_offset++);           // Reads stored AM SoftMute index value
	SsbSoftMuteIdx = EEPROM.read(addr_offset++);           // Reads stored SSB SoftMute index value
	spectrumOn = EEPROM.read(addr_offset++) != 0;          // Reads stored Spectrum on/off (never written before = 0xFF = on)

	addr_offset = eeprom_setp_address;
	for (int i = 0; i <= lastBand; i++)
	{
		band[i].bandCAL = EEPROM.read(addr_offset++) << 8;      // Reads stored Calibration value (HIGH byte) per band
		band[i].bandCAL |= EEPROM.read(addr_offset++);           // Reads stored Calibration value (LOW byte) per band
		band[i].bandMODE = EEPROM.read(addr_offset++);           // Reads stored Mode value per band
	}

	EEPROM.end();

	currentFrequency = band[bandIdx].currentFreq;
	currentMode = band[bandIdx].bandMODE;                       // G8PTN: Added to support mode per band

	if (band[bandIdx].bandType == FM_BAND_TYPE)
	{
		currentStepIdx = idxFmStep = band[bandIdx].currentStepIdx;
		rx.setFrequencyStep(tabFmStep[currentStepIdx]);
	}
	else
	{
		currentStepIdx = band[bandIdx].currentStepIdx;
		idxAmStep = currentStepIdx;
		rx.setFrequencyStep(tabAmStep[currentStepIdx]);
	}

	bwIdx = band[bandIdx].bandwidthIdx;

	if (isSSB())
	{
		loadSSB();
		bwIdxSSB = (bwIdx > 5) ? 5 : bwIdx;
		applySsbBandwidth();
		updateBFO();
	}
	else if (currentMode == AM)
	{
		bwIdxAM = bwIdx;
		rxWriteAmFilter(bandwidthAM[bwIdxAM].idx);
	}
	else
	{
		bwIdxFM = bwIdx;
		rx.setFmBandwidth(bandwidthFM[bwIdxFM].idx);
	}

	delay(50);
	rx.setVolume(volume);
}

/*
 * To store any change into the EEPROM, it is needed at least STORE_TIME  milliseconds of inactivity.
 */
void resetEepromDelay()
{
	elapsedCommand = storeTime = millis();
	itIsTimeToSave = true;
}

void showInfoMsg(const char* msg) {
	strncpy(infoMessage, msg, sizeof(infoMessage) - 1);
	infoMessage[sizeof(infoMessage) - 1] = '\0'; // Ensure null termination
	infoShow = true;
	elapsedCommand = millis();
}


/**
	Set all command flags to false
	When all flags are disabled (false), the encoder controls the frequency
*/
void disableCommands()
{
	cmdBand = false;
	bfoOn = false;
	cmdVolume = false;
	cmdAgc = false;
	cmdBandwidth = false;
	cmdStep = false;
	cmdMode = false;
	cmdMenu = false;
	cmdSoftMuteMaxAtt = false;
	countClick = 0;
	cmdCal = false;
	cmdAvc = false;
	cmdRxMode = false;
	cmdPresetGroup = false;
	cmdPresetType = false;
	cmdPresetStation = false;
	cmdFreqEdit = false;                 // The edited frequency is already tuned, so leaving keeps it
}

void drawMainVFO() {
	//ui.clearMain();
	ui.setWhiteColor();
	ui.lcd()->drawBox(0, 25, W, 155);

	if (cmdFreqEdit)
		ui.drawFrequencyEdit(editFrequency, editDigit, editNumDigits, band[bandIdx].bandType, currentMode, 270, 105);
	else
		ui.drawFrequencyBig(currentFrequency, currentBFO, band[bandIdx].bandType, currentMode, 270, 105);

	ui.draw_ic_mode(320, 70, BLACK);

	ui.setFont(Font::FONT_B20_TF);
	ui.drawString(TextAlign::CENTER, 318, 368, 94, false, false, false, getStr(modeStr, currentMode));

	ui.setFont(Font::FONT_20_TF);

	ui.draw_ic24_step(20, 35, BLACK);
	if (band[bandIdx].bandType == FM_BAND_TYPE) {
		ui.drawString(TextAlign::LEFT, 55, 0, 48, true, true, false, getStr(FmStepStr, currentStepIdx));
	}
	else {
		ui.drawString(TextAlign::LEFT, 55, 0, 48, true, true, false, getStr(AmSsbStepStr, currentStepIdx));
	}

	ui.draw_ic24_bandwidth(150, 28, BLACK);
	if (isSSB())
	{
		ui.drawString(TextAlign::LEFT, 180, 0, 48, true, true, false, getStr(bandwidthSSBStr, bwIdxSSB));
	}
	else if (currentMode == AM)
	{
		ui.drawString(TextAlign::LEFT, 180, 0, 48, true, true, false, getStr(bandwidthAMStr, bwIdxAM));
	}
	else
	{
		ui.drawString(TextAlign::LEFT, 180, 0, 48, true, true, false, getStr(bandwidthFMStr, bwIdxFM));
	}

	ui.draw_ic24_agc(273, 32, BLACK);
	if (agcNdx == 0 && agcIdx == 0) {
		ui.drawString(TextAlign::LEFT, 300, 0, 48, true, true, false, "AGC ON");
	}
	else
	{
		ui.drawStringf(TextAlign::LEFT, 300, 0, 48, true, true, false, "ATT: %2.2d", agcNdx);
	}

	// RSSI
	ui.drawRSSI(rssi, getStrength(), snr, 5, 120);

	//ui.setFont(Font::FONT_18_TF);
	if (isCW && band[bandIdx].bandType != FM_BAND_TYPE) {
		ui.setFont(Font::FONT_18_TF);
		ui.drawString(TextAlign::LEFT, 10, 0, 84, true, true, false, "CW");
		//ui.drawStringf(TextAlign::LEFT, 10, 0, 104, true, true, false, "%d", static_cast<int>(mFreq));
		//ui.drawStringf(TextAlign::LEFT, 50, 0, 104, true, true, false, "%d", cwDurationTime);
	}
	//ui.setFont(Font::FONT_18_TF);
	//ui.drawStringf(TextAlign::LEFT, 10, 0, 104, true, true, false, "%d - %d", static_cast<int>(mFreq), static_cast<int>(mMag));

	if (band[bandIdx].bandType == FM_BAND_TYPE && rx.getCurrentPilot()) {
		ui.draw_stereo(50, 75, BLACK);
	}

	drawBottomPanel();
}

// Formats a band ruler edge label: kHz below 1.8 MHz, MHz above (one decimal for FM)
void formatRulerFreq(char* buf, size_t len, uint32_t hz) {
	if (hz >= 50000000UL)
		snprintf(buf, len, "%lu.%lu MHz", (unsigned long)(hz / 1000000UL), (unsigned long)((hz / 100000UL) % 10));
	else if (hz >= 1800000UL)
		snprintf(buf, len, "%lu.%03lu MHz", (unsigned long)(hz / 1000000UL), (unsigned long)((hz / 1000UL) % 1000));
	else
		snprintf(buf, len, "%lu kHz", (unsigned long)(hz / 1000UL));
}

// Tuned frequency in Hz, including the BFO in SSB
uint32_t getTunedHz() {
	if (band[bandIdx].bandType == FM_BAND_TYPE)
		return (uint32_t)currentFrequency * 10000UL;
	int32_t hz = (int32_t)currentFrequency * 1000;
	if (isSSB()) hz += currentBFO;
	return hz < 0 ? 0 : hz;
}

// First preset at or above hz (presets[] is sorted by frequency)
uint16_t presetLowerBound(uint32_t hz) {
	uint16_t lo = 0, hi = PRESET_COUNT;
	while (lo < hi) {
		uint16_t mid = (lo + hi) / 2;
		if (presets[mid].hz < hz) lo = mid + 1;
		else hi = mid;
	}
	return lo;
}

// Preset the receiver is tuned to, or -1. USB/LSB presets cover the 3 kHz passband on their side
// of the dial frequency, CW +/- 500 Hz and AM +/- 2.5 kHz. The closest one wins.
int16_t findPresetAt(uint32_t hz) {
	if (band[bandIdx].bandType == FM_BAND_TYPE) return -1;

	int16_t best = -1;
	int32_t bestDist = INT32_MAX;
	for (uint16_t i = presetLowerBound(hz > 3000 ? hz - 3000 : 0); i < PRESET_COUNT && presets[i].hz <= hz + 3000; i++) {
		int32_t d = (int32_t)hz - (int32_t)presets[i].hz;
		bool inside;
		switch (presets[i].mode) {
		case USB: inside = d >= 0 && d < 3000; break;
		case LSB: inside = d <= 0 && d > -3000; break;
		case CW:  inside = abs(d) <= 500; break;
		default:  inside = abs(d) <= 2500; break;
		}
		if (inside && abs(d) < bestDist) {
			best = i;
			bestDist = abs(d);
		}
	}
	return best;
}

void drawBandRuler() {
	static uint32_t marks[160];

	bool isFM = band[bandIdx].bandType == FM_BAND_TYPE;
	uint32_t unit = isFM ? 10000UL : 1000UL;
	uint32_t minHz = band[bandIdx].minimumFreq * unit;
	uint32_t maxHz = band[bandIdx].maximumFreq * unit;
	uint32_t curHz = getTunedHz();

	// The band plan and the preset markers only make sense on the narrow bands, not on Whole SW or FM
	bool showPlan = !isFM && (band[bandIdx].maximumFreq - band[bandIdx].minimumFreq) <= 2000;

	uint16_t numMarks = 0;
	if (showPlan) {
		for (uint16_t i = presetLowerBound(minHz); i < PRESET_COUNT && presets[i].hz <= maxHz && numMarks < 160; i++)
			marks[numMarks++] = presets[i].hz;
	}

	// Middle of the ruler: the preset being received with its mode, else the band and the band plan segment
	const char* title = band[bandIdx].bandName;
	const char* chip = nullptr;
	int16_t p = findPresetAt(curHz);
	if (p >= 0) {
		title = presets[p].name;
		chip = getStr(modeStr, presets[p].mode);
	}
	else if (showPlan) {
		uint16_t kHz = curHz / 1000;
		for (uint8_t i = 0; i < bandPlanCount && chip == nullptr; i++)
			if (kHz >= bandPlan[i].startKHz && kHz < bandPlan[i].endKHz) chip = bandPlan[i].name;
	}

	char left[16], right[16];
	formatRulerFreq(left, sizeof(left), minHz);
	formatRulerFreq(right, sizeof(right), maxHz);

	ui.drawBandRuler(minHz, maxHz, curHz,
		showPlan ? bandPlan : nullptr, showPlan ? bandPlanCount : 0,
		marks, numMarks,
		left, right, title, chip);
}

// Fits a string into maxWidth pixels with the current font, cutting it at the end
void fitString(char* buf, size_t len, const char* str, u8g2_uint_t maxWidth) {
	strncpy(buf, str, len - 1);
	buf[len - 1] = '\0';
	size_t n = strlen(buf);
	while (n > 0 && ui.lcd()->getStrWidth(buf) > maxWidth) {
		buf[--n] = '\0';
	}
}

/**
 * Bottom panel: RDS in FM, the CW decoder when enabled, otherwise the band ruler.
 */
void drawBottomPanel() {
	ui.setBlackColor();
	ui.lcd()->drawBox(0, BOTTOM_Y, W, H - BOTTOM_Y);
	ui.setWhiteColor();

	if (band[bandIdx].bandType == FM_BAND_TYPE && stationName != nullptr) {
		ui.setFont(Font::FONT_B20_TF);
		ui.drawStringf(TextAlign::CENTER, 10, 390, 205, false, false, false, "%s", stationName);
		if (rdsMsg != nullptr) {
			char line[65];
			ui.setFont(Font::FONT_18_TF);
			fitString(line, sizeof(line), rdsMsg, W - 10);
			ui.drawString(TextAlign::CENTER, 5, W - 5, 226, false, false, false, line);
		}
	}
	else if (decodeCW && band[bandIdx].bandType != FM_BAND_TYPE) {
		ui.setFont(Font::FONT_18_TF);
		ui.lcd()->drawRBox(4, 189, 30, 16, 3);
		ui.setBlackColor();
		ui.lcd()->drawStr(9, 201, "CW");
		ui.setWhiteColor();
		ui.lcd()->drawStr(42, 201, morseBuffer);
		ui.lcd()->drawStr(5, 224, textBuffer);
	}
	else {
		drawBandRuler();
	}

}


uint8_t intensityToColor(int intensity) {
	uint8_t color;

	if (intensity == 0) {
		color = 0;
	}
	else if (intensity < 8) {
		color = 0;
	}
	else {
		color = 1;
	}

	return color;
}


void getAudioData() {
	// Reset bandValues[]
	for (int i = 0; i < NUM_BANDS; i++) {
		bandValues[i] = 0;
	}

	peak = 0;

	float maxPeak = 0;
	float minPeak = 0;

	newTime = micros();
	for (int i = 0; i < SAMPLES; i++) {
		vReal[i] = analogRead(AUDIO_INPUT);
		vImag[i] = 0;
		while (micros() - newTime < sampling_period_us) {
		}
		newTime += sampling_period_us;
		if (maxPeak < vReal[i]) {
			maxPeak = vReal[i];
		}
		if (minPeak > vReal[i]) {
			minPeak = vReal[i];
		}
	}

	peak = (maxPeak - minPeak) / 2;

	// Compute FFT
	FFT.dcRemoval();
	//FFT.windowing(FFT_WIN_TYP_HAMMING, FFT_FORWARD); // FFT_WIN_TYP_HAMMING
	FFT.compute(FFT_FORWARD);
	FFT.complexToMagnitude();

	if (decodeCW) {
		float mFreq = 0;
		float mMag = 0;
		// get major peak frequency and value	
		FFT.majorPeak(&mFreq, &mMag);

		if ((mFreq > FREQ_MIN && mFreq < FREQ_MAX) && mMag > SIGNAL_THRESHOLD) {
			isCW = true;
			//cwTime = millis();
		}
		else {
			isCW = false;
			//cwDurationTime = millis() - cwTime;
			//cwTime = millis();
		}

		// Debug info
		/*if (mMag > SIGNAL_THRESHOLD) {
			Serial.print("Signal: ");
			Serial.print(mMag);
			Serial.print(" at ");
			Serial.println(mFreq);
		}*/

		/*
		// Find peak frequency in our range of interest
		double peak = 0;
		int peakIndex = 0;

		// Only examine the frequency range we're interested in
		int minIndex = (FREQ_MIN * SAMPLES) / SAMPLING_FREQ;
		int maxIndex = (FREQ_MAX * SAMPLES) / SAMPLING_FREQ;

		for (int i = minIndex; i <= maxIndex; i++) {
			if (vReal[i] > peak) {
				peak = vReal[i];
				peakIndex = i;
			}
		}

		// Calculate actual frequency
		double dominantFreq = (peakIndex * SAMPLING_FREQ) / SAMPLES;

		// Debug info
		if (peak > SIGNAL_THRESHOLD) {
		  Serial.print("Signal: ");
		  Serial.print(peak);
		  Serial.print(" at ");
		  Serial.println(dominantFreq);
		}

		// true if signal is detected within our frequency range and above threshold
		if (peak > SIGNAL_THRESHOLD && dominantFreq >= FREQ_MIN && dominantFreq <= FREQ_MAX) {
			isCW = true;
		}
		else {
			isCW = false;
		}
		*/

		// Signal just started
		if (isCW && !wasSignalDetected) {
			signalStart = millis();

			// If there was silence before, check if it's a gap between elements
			if (silenceStart > 0) {
				unsigned long silenceDuration = signalStart - silenceStart;
				processSilence(silenceDuration);
			}

			silenceStart = 0;
		}

		// Signal just ended
		if (!isCW && wasSignalDetected) {
			signalEnd = millis();
			silenceStart = signalEnd;

			// Calculate the duration of the signal
			unsigned long signalDuration = signalEnd - signalStart;
			processMorseElement(signalDuration);
		}

		// Check for long silence (might indicate end of character or word)
		if (!isCW && silenceStart > 0) {
			unsigned long currentSilence = millis() - silenceStart;

			// Only process once when threshold is crossed
			static bool letterGapProcessed = false;
			static bool wordGapProcessed = false;

			if (currentSilence >= LETTER_GAP && !letterGapProcessed) {
				processSilence(LETTER_GAP);
				letterGapProcessed = true;
			}

			if (currentSilence >= WORD_GAP && !wordGapProcessed) {
				processSilence(WORD_GAP);
				wordGapProcessed = true;
			}

			// Reset flags when signal is detected again
			if (isCW) {
				letterGapProcessed = false;
				wordGapProcessed = false;
			}
		}

		wasSignalDetected = isCW;
	}
}

#define TOP 20
void drawSpectrum(int x, int y) {

	//peak = 0;
	int maxMagnitude = 0;
	for (int i = 0; i < SAMPLES / 2; i++) {

		if (vReal[i] > maxMagnitude) {
			maxMagnitude = vReal[i];
		}
	}

	if (maxMagnitude < 9000) {
		maxMagnitude = 9000;
	}

	for (int col = 0; col < SAMPLES / 2; ++col) {
		//bandValues[col] = map(vReal[col], NOISE, 4000, 0, 60);		
		bandValues[col] = static_cast<int>((vReal[col] / maxMagnitude) * TOP);
		waterfallData[0][col] = bandValues[col];
		/*if (vReal[col] > 5000) {
			peak += vReal[col] - 5000;
		}*/
	}

	// Process the FFT data into bar heights

	ui.setBlackColor();
	ui.lcd()->drawBox(x - 1, y, 130, TOP);

	//uint16_t vuRead = static_cast<int>((peak / 15000) * 130);
	uint16_t vuRead = map(peak, 2000, 5000, 0, 130);
	if (vuRead > 130) vuRead = 130;
	if (vuRead < 0) vuRead = 0;

	/*if (vuRead > vu) {
		vu = vuRead;
	}*/

	vu = vuRead;

	ui.lcd()->drawBox(x - 1, y - 5, vu, 4);

	//if (vu > 0) vu -= 5;

	ui.setWhiteColor();
	for (int band = 0; band < NUM_BANDS; band++) {
		// Scale the bars for the display
		int barHeight = bandValues[band];
		if (barHeight > TOP) barHeight = TOP;

		if (band > 0) {
			ui.lcd()->drawLine(x + band - 1, (y + TOP) - oldBarHeights[band - 1], x + band, (y + TOP) - barHeight);
		}

		oldBarHeights[band] = barHeight;
	}

	for (int row = NUM_WATERFALL_ROWS - 1; row > 0; --row) {
		for (int col = 0; col < NUM_BANDS; ++col) {
			waterfallData[row][col] = waterfallData[row - 1][col];
		}
	}

	ui.setBlackColor();
	ui.lcd()->drawBox(x - 1, y + TOP + 1, 130, NUM_WATERFALL_ROWS);
	ui.setWhiteColor();

	for (int row = 0; row < NUM_WATERFALL_ROWS; ++row) {
		for (int col = 0; col < NUM_BANDS; ++col) {
			int intensity = waterfallData[row][col];
			uint8_t color = intensityToColor(intensity);

			if (color == 1) {
				ui.lcd()->drawPixel(x + col, y + (TOP + 1) + row);
			}
		}
	}

}

/**
 * Shows some basic information on display
 */
void showStatus()
{
	ui.drawStatus(rx.getVolume(), itIsTimeToSave);

}

void cleanBfoRdsInfo()
{
	rdsMsg = nullptr;
	stationName = nullptr;
	rdsTime = nullptr;
}

/* ---------------------------------------- */
/* RX Mode: receiver profiles (rx_profiles.h) that set AGC, AVC, SoftMute and bandwidth together.     */
/* They only write the usual per mode settings, so the user can fine tune any of them afterwards     */
/* (the menu then shows Custom)                                                                      */

// True if the profile can be used in the current mode as it is (without a mode change)
bool rxProfileFitsMode(const RxProfile& p) {
	if (p.mode == RXP_ANY) return true;
	if (p.mode == RXP_SSB) return currentMode == LSB || currentMode == USB;
	return p.mode == currentMode;
}

// AGC/ATTN menu index of a profile: 0 = AGC on, n = AGC off with attenuation n - 1
uint8_t rxProfileAgcIdx(const RxProfile& p) {
	return p.agcEnabled ? 0 : p.attenuation + 1;
}

// Profile matching the current settings, or -1 (Custom)
int8_t findRxProfile() {
	if (currentMode == FM) return -1;
	for (uint8_t i = 0; i < rxProfileCount; i++) {
		const RxProfile& p = rxProfiles[i];
		if (!rxProfileFitsMode(p) || rxProfileAgcIdx(p) != agcIdx || p.avcMaxGain != currentAVC) continue;
		if (isSSB() ? (bwIdxSSB == p.bwSSB && softMuteMaxAttIdx == p.softMuteSSB)
		            : (bwIdxAM == p.bwAM && softMuteMaxAttIdx == p.softMuteAM)) return i;
	}
	return -1;
}

// Current value of each main menu option, shown at the right of the option.
// "--" marks the options that are not available in the current mode.
const char* mainMenuValue(uint8_t idx) {
	static char buf[16];

	switch (idx) {
	case STEP:
		u8x8_CopyStringLine(buf, currentStepIdx, currentMode == FM ? FmStepStr : AmSsbStepStr);
		break;
	case BAND:
		strncpy(buf, band[bandIdx].bandName, sizeof(buf) - 1);
		buf[sizeof(buf) - 1] = '\0';
		break;
	case MODE:
		u8x8_CopyStringLine(buf, currentMode, modeStr);
		break;
	case RXMODE: {
		if (currentMode == FM) return "--";
		int8_t p = findRxProfile();
		return (p < 0) ? "Custom" : rxProfiles[p].name;
	}
	case VOLUME:
		snprintf(buf, sizeof(buf), "%ld%%", map(muted ? mute_vol_val : rx.getVolume(), 0, 63, 0, 100));
		break;
	case BW:
		if (currentMode == FM)  u8x8_CopyStringLine(buf, bwIdxFM, bandwidthFMStr);
		else if (isSSB())       u8x8_CopyStringLine(buf, bwIdxSSB, bandwidthSSBStr);
		else                    u8x8_CopyStringLine(buf, bwIdxAM, bandwidthAMStr);
		break;
	case MUTE:
		return muted ? "ON" : "OFF";
	case AGC_ATT:
		if (agcIdx == 0) return "AGC";
		snprintf(buf, sizeof(buf), "ATT %d", agcNdx);
		break;
	case SOFTMUTE:
		if (currentMode == FM) return "--";
		snprintf(buf, sizeof(buf), "%d dB", softMuteMaxAttIdx);
		break;
	case AVC:
		if (currentMode == FM) return "--";
		snprintf(buf, sizeof(buf), "%d dB", currentAVC);
		break;
	case SEEKUP:
	case SEEKDOWN:
		return isSSB() ? "--" : nullptr;
	case CALIBRATION:
		if (!isSSB()) return "--";
		snprintf(buf, sizeof(buf), "%+d Hz", band[bandIdx].bandCAL);
		break;
	case DECODECW:
		if (!isSSB()) return "--";
		return decodeCW ? "ON" : "OFF";
	case SPECTRUM:
		return spectrumOn ? "ON" : "OFF";
	default:
		return nullptr;
	}
	return buf;
}

/* ---------------------------------------- */
/* Presets menu: band (group) -> type -> station. The presets live in flash (presets.h) and are   */
/* never changed: applying one only tunes the receiver, which the user can then change freely.    */

uint8_t presetGroup = 0;                            // Selected group
uint8_t presetTypes[PRESET_TYPE_COUNT];             // Types present in the selected group
uint8_t presetTypeCount = 0;
uint8_t presetType = 0;                             // Selected type
uint16_t presetList[PRESET_MAX_LIST];               // presets[] index of each station line
uint8_t presetListCount = 0;
char presetMenuBuf[1536];                           // '\n' separated lines of the list on screen

// Appends a menu line to presetMenuBuf
void presetMenuAdd(size_t& len, const char* line) {
	size_t n = strlen(line);
	if (len + n + 2 > sizeof(presetMenuBuf)) return;
	if (len > 0) presetMenuBuf[len++] = '\n';
	memcpy(presetMenuBuf + len, line, n);
	len += n;
	presetMenuBuf[len] = '\0';
}

uint16_t presetCount(uint8_t group, int16_t type) {
	uint16_t n = 0;
	for (uint16_t i = 0; i < PRESET_COUNT; i++)
		if (presets[i].group == group && (type < 0 || presets[i].type == type)) n++;
	return n;
}

// List values: number of stations for groups and types, the frequency in kHz for stations
const char* presetGroupValue(uint8_t idx) {
	static char buf[8];
	if (idx == 0) return nullptr;
	snprintf(buf, sizeof(buf), "%u", presetCount(idx - 1, -1));
	return buf;
}

const char* presetTypeValue(uint8_t idx) {
	static char buf[8];
	if (idx == 0) return nullptr;
	snprintf(buf, sizeof(buf), "%u", presetCount(presetGroup, presetTypes[idx - 1]));
	return buf;
}

const char* presetStationValue(uint8_t idx) {
	static char buf[12];
	if (idx == 0) return nullptr;
	uint32_t hz = presets[presetList[idx - 1]].hz;
	unsigned long khz = hz / 1000, rem = hz % 1000;
	if (rem == 0)             snprintf(buf, sizeof(buf), "%lu", khz);
	else if (rem % 100 == 0)  snprintf(buf, sizeof(buf), "%lu.%lu", khz, rem / 100);
	else if (rem % 10 == 0)   snprintf(buf, sizeof(buf), "%lu.%02lu", khz, rem / 10);
	else                      snprintf(buf, sizeof(buf), "%lu.%03lu", khz, rem);
	return buf;
}

void openPresetGroups() {
	disableCommands();
	size_t len = 0;
	presetMenuBuf[0] = '\0';
	presetMenuAdd(len, "Back");
	for (uint8_t g = 0; g < PRESET_GROUP_COUNT; g++)
		presetMenuAdd(len, presetGroupNames[g]);
	cmdPresetGroup = true;
	ui.setMenu(presetGroup + 1, presetMenuBuf, presetGroupValue);
}

void openPresetStations() {
	disableCommands();
	size_t len = 0;
	presetMenuBuf[0] = '\0';
	presetMenuAdd(len, "Back");
	presetListCount = 0;
	uint8_t start = 1;
	int16_t tuned = findPresetAt(getTunedHz());
	for (uint16_t i = 0; i < PRESET_COUNT && presetListCount < PRESET_MAX_LIST; i++) {
		if (presets[i].group != presetGroup || presets[i].type != presetType) continue;
		if (i == tuned) start = presetListCount + 1;          // Start on the station being received
		presetList[presetListCount++] = i;
		presetMenuAdd(len, presets[i].name);
	}
	cmdPresetStation = true;
	ui.setMenu(start, presetMenuBuf, presetStationValue);
}

// Types of the selected group. With a single type the type list is skipped
void openPresetTypes() {
	presetTypeCount = 0;
	for (uint8_t t = 0; t < PRESET_TYPE_COUNT; t++)
		if (presetCount(presetGroup, t) > 0) presetTypes[presetTypeCount++] = t;

	if (presetTypeCount == 1) {
		presetType = presetTypes[0];
		openPresetStations();
		return;
	}

	disableCommands();
	size_t len = 0;
	presetMenuBuf[0] = '\0';
	presetMenuAdd(len, "Back");
	uint8_t start = 1;
	for (uint8_t i = 0; i < presetTypeCount; i++) {
		if (presetTypes[i] == presetType) start = i + 1;
		presetMenuAdd(len, presetTypeNames[presetTypes[i]]);
	}
	cmdPresetType = true;
	ui.setMenu(start, presetMenuBuf, presetTypeValue);
}

// Opens the presets on the group of the station being received, or of the nearest preset
void openPresets() {
	uint32_t hz = getTunedHz();
	int16_t p = findPresetAt(hz);
	if (p < 0 && band[bandIdx].bandType != FM_BAND_TYPE) {
		uint16_t i = presetLowerBound(hz);
		p = (i < PRESET_COUNT) ? i : PRESET_COUNT - 1;
	}
	if (p >= 0) {
		presetGroup = presets[p].group;
		presetType = presets[p].type;
	}
	openPresetGroups();
}

void backToMainMenu() {
	disableCommands();
	cmdMenu = true;
	ui.setMenu(menuIdx, MenuStr, mainMenuValue);
}

/**
 * Tunes a preset: selects the narrowest band that contains it, sets the mode and a filter that
 * suits it, and the exact frequency (the Hz go to the BFO in SSB/CW).
 */
void applyPreset(const Preset& p) {
	uint16_t kHz = (p.mode == AM) ? (p.hz + 500) / 1000 : p.hz / 1000;

	int target = -1;
	uint16_t span = 0xFFFF;
	for (int i = 0; i <= lastBand; i++) {
		if (band[i].bandType == FM_BAND_TYPE) continue;
		if (kHz >= band[i].minimumFreq && kHz <= band[i].maximumFreq && band[i].maximumFreq - band[i].minimumFreq < span) {
			target = i;
			span = band[i].maximumFreq - band[i].minimumFreq;
		}
	}
	if (target < 0) return;

	// Leave the current band as it is now, like a band change does
	band[bandIdx].currentFreq = currentFrequency + (currentBFO / 1000);
	band[bandIdx].currentStepIdx = currentStepIdx;
	currentBFO = 0;

	bandIdx = target;
	band[bandIdx].bandMODE = p.mode;
	band[bandIdx].currentFreq = kHz;
	bool narrow = p.flags & PRESET_NARROW;
	if (p.mode == AM)       band[bandIdx].bandwidthIdx = narrow ? 4 : 6;    // 3.0 / 6.0 kHz
	else if (p.mode == CW)  band[bandIdx].bandwidthIdx = narrow ? 0 : 1;    // 0.5 / 1.0 kHz
	else                    band[bandIdx].bandwidthIdx = 4;                 // 3.0 kHz
	bwIdxBeforeCW = -1;

	currentMode = p.mode;
	if (isSSB()) {
		if (!ssbLoaded) {
			ui.drawLoading();
			ui.updateDisplay();
			bwIdxSSB = band[bandIdx].bandwidthIdx;
			loadSSB();
		}
	}
	else {
		ssbLoaded = false;
	}

	useBand();

	if (isSSB()) {
		currentBFO = p.hz - (uint32_t)kHz * 1000;
		updateBFO();
	}

	decodeCW = decodeCW && isSSB();
	resetEepromDelay();
}

void presetMenuSelect() {
	uint8_t pos = ui.getListPos();

	if (cmdPresetGroup) {
		if (pos == 0) { backToMainMenu(); return; }
		if (presetGroup != pos - 1) presetType = 0xFF;      // New group: start on its first type
		presetGroup = pos - 1;
		openPresetTypes();
	}
	else if (cmdPresetType) {
		if (pos == 0) { openPresetGroups(); return; }
		presetType = presetTypes[pos - 1];
		openPresetStations();
	}
	else if (cmdPresetStation) {
		if (pos == 0) {
			if (presetTypeCount > 1) openPresetTypes();
			else openPresetGroups();
			return;
		}
		applyPreset(presets[presetList[pos - 1]]);
		disableCommands();
	}
}

/**
 *   Sets Band up (1) or down (!1)
 */
void setBand(int8_t up_down)
{
	// G8PTN: Reset BFO when changing band and store frequency
	band[bandIdx].currentFreq = currentFrequency + (currentBFO / 1000);
	currentBFO = 0;

	band[bandIdx].currentStepIdx = currentStepIdx;
	if (up_down == -1)                                            // G8PTN: Corrected direction
		bandIdx = (bandIdx < lastBand) ? (bandIdx + 1) : 0;
	else
		bandIdx = (bandIdx > 0) ? (bandIdx - 1) : lastBand;

	// G8PTN: Added to support mode per band
	currentMode = band[bandIdx].bandMODE;

	ui.setListPos(bandIdx);

	if (isSSB())
	{
		if (ssbLoaded == false)
		{
			// Only loadSSB if not already loaded      
			ui.drawLoading();
			ui.updateDisplay();

			loadSSB();
			ssbLoaded = true;
		}
	}
	else {
		// If not SSB
		ssbLoaded = false;
	}

	useBand();
	delay(MIN_ELAPSED_TIME); // waits a little more for releasing the button.
	elapsedCommand = millis();
}


/**
 * Switch the radio to current band
 */
void useBand()
{
	currentMode = band[bandIdx].bandMODE;                  // G8PTN: Added to support mode per band
	rxInvalidate();                                        // setFM/setAM/setSSB may power the chip up again: rewrite all RX settings
	if (band[bandIdx].bandType == FM_BAND_TYPE)
	{
		currentMode = FM;
		rx.setFM(band[bandIdx].minimumFreq, band[bandIdx].maximumFreq, band[bandIdx].currentFreq, tabFmStep[band[bandIdx].currentStepIdx]);
		rx.setTuneFrequencyAntennaCapacitor(0);   // Must follow setFM(): the library encodes ANTCAP for the mode currently powered up
		rx.setSeekFmLimits(band[bandIdx].minimumFreq, band[bandIdx].maximumFreq);
		bfoOn = ssbLoaded = false;
		bwIdxFM = band[bandIdx].bandwidthIdx;
		rx.setFmBandwidth(bandwidthFM[bwIdxFM].idx);
		rx.setFMDeEmphasis(1);
		rx.RdsInit();
		rx.setRdsConfig(1, 2, 2, 2, 2);
		rx.setGpioCtl(1, 0, 0);   // G8PTN: Enable GPIO1 as output
		rx.setGpio(0, 0, 0);      // G8PTN: Set GPIO1 = 0
	}
	else
	{
		if (ssbLoaded)
		{
			// Configure SI4732 for SSB
			rx.setSSB(
				band[bandIdx].minimumFreq,
				band[bandIdx].maximumFreq,
				band[bandIdx].currentFreq,
				0,                                                  // SI4732 step is not used for SSB!
				getSsbSideband());

			// SSB AVC (always enabled) and the sideband cutoff filter are written with the bandwidth by applySsbBandwidth()
			if (band[bandIdx].bandwidthIdx > 5) bwIdxSSB = 5;   // G8PTN: Limit value
			else bwIdxSSB = band[bandIdx].bandwidthIdx;
			applySsbBandwidth();
			updateBFO();                                          // G8PTN: If SSB is loaded update BFO
		}
		else
		{
			currentMode = AM;
			rx.setAM(
				band[bandIdx].minimumFreq,
				band[bandIdx].maximumFreq,
				band[bandIdx].currentFreq,
				band[bandIdx].currentStepIdx >= AmTotalSteps ? 1 : tabAmStep[band[bandIdx].currentStepIdx]);   // Set to 1kHz

			bfoOn = false;
			bwIdxAM = band[bandIdx].bandwidthIdx;
			rxWriteAmFilter(bandwidthAM[bwIdxAM].idx);
			//rx.setAmSoftMuteMaxAttenuation(softMuteMaxAttIdx); //Soft Mute for AM or SSB
		}
		// Set the tuning capacitor for SW or MW/LW. Must follow setAM()/setSSB(): coming from FM, the library
		// would otherwise encode the value in the FM byte layout (SW would get ANTCAP 256 = ~31 pF instead of 1)
		rx.setTuneFrequencyAntennaCapacitor((band[bandIdx].bandType == MW_BAND_TYPE || band[bandIdx].bandType == LW_BAND_TYPE) ? 0 : 1);
		rx.setGpioCtl(1, 0, 0);   // G8PTN: Enable GPIO1 as output
		rx.setGpio(1, 0, 0);      // G8PTN: Set GPIO1 = 1
		rx.setSeekAmLimits(band[bandIdx].minimumFreq, band[bandIdx].maximumFreq); // Consider the range all defined current band
		rx.setSeekAmSpacing(5); // Max 10kHz for spacing

	}

	// G8PTN: Added
	// Call doSoftMute(0), 0 = No incr/decr action (eqivalent to getSoftMute)
	// This gets softMuteMaxAttIdx based on mode (AM, SSB)  
	doSoftMute(0);

	// Call doAgc(0), 0 = No incr/decr action (eqivalent to getAgc)
	// This gets disableAgc and agcNdx values based on mode (FM, AM , SSB)  
	doAgc(0);

	// Call doAvc(0), 0 = No incr/decr action (eqivalent to getAvc)
	// This gets currentAVC values based on mode (AM, SSB)
	doAvc(0);

	delay(100);

	// Default
	currentFrequency = band[bandIdx].currentFreq;
	currentStepIdx = band[bandIdx].currentStepIdx;    // Default. Need to modify for AM/SSB as required


	if (currentMode == FM)
		idxFmStep = band[bandIdx].currentStepIdx;
	else
	{
		// Default for AM/SSB
		idxAmStep = band[bandIdx].currentStepIdx;


		// Update depending on currentMode and currentStepIdx
		// If outside SSB step ranges
		if (isSSB() && currentStepIdx >= AmTotalStepsSsb && currentStepIdx < AmTotalSteps)
		{
			currentStepIdx = 0;;
			idxAmStep = 0;
			band[bandIdx].currentStepIdx = 0;
		}

		// If outside AM step ranges
		if (currentMode == AM && currentStepIdx >= AmTotalSteps)
		{
			currentStepIdx = 0;;
			idxAmStep = 0;
			band[bandIdx].currentStepIdx = 0;
		}

	}

	/*
	// G8PTN: Why is this required?
	if ((bandIdx == LW_BAND_TYPE || bandIdx == MW_BAND_TYPE)
		&& idxAmStep > AmTotalStepsSsb)
		idxAmStep = AmTotalStepsSsb;
	*/

	// Store mode
	band[bandIdx].bandMODE = currentMode;               // G8PTN: Added to support mode per band

	rssi = 0;
	snr = 0;
	cleanBfoRdsInfo();
	showStatus();
}

void loadSSB() {
	rx.setI2CFastModeCustom(400000); // You can try rx.setI2CFastModeCustom(700000); or greater value
	rx.loadPatch(ssb_patch_content, size_content, bandwidthSSB[bwIdxSSB].idx);
	rx.setI2CFastModeCustom(100000); // 400 kHz only for the patch download, normal operation at 100 kHz
	rxInvalidate();                  // The patch power up resets the RX settings
	ssbLoaded = true;
}

/**
 *  Switches the Bandwidth
 */
void doBandwidth(int8_t v)
{
	if (isSSB())
	{
		bwIdxSSB = (v == -1) ? bwIdxSSB + 1 : bwIdxSSB - 1;

		if (bwIdxSSB > maxSsbBw)
			bwIdxSSB = 0;
		else if (bwIdxSSB < 0)
			bwIdxSSB = maxSsbBw;

		applySsbBandwidth();

		band[bandIdx].bandwidthIdx = bwIdxSSB;
	}
	else if (currentMode == AM)
	{
		bwIdxAM = (v == -1) ? bwIdxAM + 1 : bwIdxAM - 1;

		if (bwIdxAM > maxAmBw)
			bwIdxAM = 0;
		else if (bwIdxAM < 0)
			bwIdxAM = maxAmBw;

		rxWriteAmFilter(bandwidthAM[bwIdxAM].idx);
		band[bandIdx].bandwidthIdx = bwIdxAM;

	}
	else {
		bwIdxFM = (v == -1) ? bwIdxFM + 1 : bwIdxFM - 1;
		if (bwIdxFM > maxFmBw)
			bwIdxFM = 0;
		else if (bwIdxFM < 0)
			bwIdxFM = maxFmBw;

		rx.setFmBandwidth(bandwidthFM[bwIdxFM].idx);
		band[bandIdx].bandwidthIdx = bwIdxFM;
	}

	ui.setListPos(band[bandIdx].bandwidthIdx);
	delay(MIN_ELAPSED_TIME); // waits a little more for releasing the button.
}

/**
 *  AGC and attenuattion setup
 */
void doAgc(int8_t v) {

	// G8PTN: Modified to have separate AGC/ATTN per mode (FM, AM, SSB)
	if (currentMode == FM) {
		if (v == 1)   FmAgcIdx++;
		else if (v == -1)  FmAgcIdx--;

		// Limit range
		if (FmAgcIdx < 0)
			FmAgcIdx = 27;
		else if (FmAgcIdx > 27)
			FmAgcIdx = 0;

		// Select
		agcIdx = FmAgcIdx;
	}

	else if (isSSB()) {
		if (v == 1)   SsbAgcIdx++;
		else if (v == -1)  SsbAgcIdx--;

		// Limit range. Same as AM: SSB_AGC_OVERRIDE is the AM_AGC_OVERRIDE command (0x48) with the same
		// gain index, so strong signal overload can be fought with attenuation in SSB/CW too
		if (SsbAgcIdx < 0)
			SsbAgcIdx = 37;
		else if (SsbAgcIdx > 37)
			SsbAgcIdx = 0;

		// Select
		agcIdx = SsbAgcIdx;
	}

	else {
		if (v == 1)   AmAgcIdx++;
		else if (v == -1)  AmAgcIdx--;

		// Limit range
		if (AmAgcIdx < 0)
			AmAgcIdx = 37;
		else if (AmAgcIdx > 37)
			AmAgcIdx = 0;

		// Select
		agcIdx = AmAgcIdx;
	}

	// Process agcIdx to generate disableAgc and agcIdx
	// agcIdx     0 1 2 3 4 5 6  ..... n    (n:    FM = 27, AM/SSB = 37)
	// agcNdx     0 0 1 2 3 4 5  ..... n -1 (n -1: FM = 26, AM/SSB = 36)
	// disableAgc 0 1 1 1 1 1 1  ..... 1
	// Note: agcIdx 1 (ATT 0) is AGC OFF at MAXIMUM gain, not "no attenuation with AGC": it overloads first
	disableAgc = (agcIdx > 0);     // if true, disable AGC; else, AGC is enabled
	if (agcIdx > 1)
		agcNdx = agcIdx - 1;
	else
		agcNdx = 0;

	// Configure SI4732/5
	rxWriteAgc(disableAgc, agcNdx);                 // if agcNdx = 0, no attenuation

	delay(MIN_ELAPSED_TIME); // waits a little more for releasing the button.
	elapsedCommand = millis();
}

/**
 * Switches the current step
 */
void doStep(int8_t v)
{
	//selectMenuList(v);

	if (currentMode == FM) {
		idxFmStep = (v == 1) ? idxFmStep - 1 : idxFmStep + 1;
		if (idxFmStep > lastFmStep)
			idxFmStep = 0;
		else if (idxFmStep < 0)
			idxFmStep = lastFmStep;

		currentStepIdx = idxFmStep;
		rx.setFrequencyStep(tabFmStep[currentStepIdx]);
	}

	else {
		idxAmStep = (v == 1) ? idxAmStep - 1 : idxAmStep + 1;
		if (idxAmStep > getLastStep())
			idxAmStep = 0;
		else if (idxAmStep < 0)
			idxAmStep = getLastStep();

		//SSB Step limit
		/*else if (isSSB() && idxAmStep >= AmTotalStepsSsb && idxAmStep < AmTotalSteps)
			idxAmStep = v == 1 ? AmTotalSteps : AmTotalStepsSsb - 1;*/

			// G8PTN: Reduced steps for LW/MW now covered in getLastStep()
			/*
			//LW/MW Step limit
			else if ((bandIdx == LW_BAND_TYPE || bandIdx == MW_BAND_TYPE)
				&& v == 1 && idxAmStep > AmTotalStepsSsb && idxAmStep < AmTotalSteps)
				idxAmStep = AmTotalSteps;
			else if ((bandIdx == LW_BAND_TYPE || bandIdx == MW_BAND_TYPE)
				&& v != 1 && idxAmStep > AmTotalStepsSsb && idxAmStep < AmTotalSteps)
				idxAmStep = AmTotalStepsSsb;
			*/

		if (!isSSB() || isSSB() && idxAmStep < AmTotalSteps)
		{
			currentStepIdx = idxAmStep;
			rx.setFrequencyStep(tabAmStep[idxAmStep]);
		}

		/*
		if (!isSSB())
			rx.setSeekAmSpacing((band[bandIdx].currentStepIdx >= AmTotalSteps) ? 1 : tabStep[band[bandIdx].currentStepIdx]);
		*/

		currentStepIdx = idxAmStep;
		//rx.setFrequencyStep(tabAmStep[currentStepIdx]);
		rx.setSeekAmSpacing(5); // Max 10kHz for spacing
	}

	band[bandIdx].currentStepIdx = currentStepIdx;
	ui.setListPos(currentStepIdx);
	elapsedCommand = millis();
}

/**
 * Switches to the AM, LSB, USB or CW modes
 */
const uint8_t modeCycle[] = { AM, LSB, USB, CW };
const uint8_t modeCycleLen = sizeof(modeCycle) / sizeof(modeCycle[0]);
int8_t bwIdxBeforeCW = -1;              // SSB bandwidth to restore when leaving CW

// Switches the current band (not FM) to AM, LSB, USB or CW
void setMode(uint8_t newMode)
{
	currentMode = band[bandIdx].bandMODE;               // G8PTN: Added to support mode per band
	if (currentMode == FM || newMode == currentMode) return;

	if (currentMode == AM)
	{
		// If you were in AM mode, it is necessary to load SSB patch (every time)

		ui.drawLoading();
		ui.updateDisplay();

		loadSSB();
		ssbLoaded = true;
	}
	else if (newMode == AM)
	{
		bfoOn = ssbLoaded = false;

		// G8PTN: When exiting SSB mode update the current frequency and BFO
		currentFrequency = currentFrequency + (currentBFO / 1000);
		currentBFO = 0;
	}

	// CW starts on the 0.5 kHz band-pass filter; the previous bandwidth comes back when leaving CW
	if (newMode == CW)
	{
		bwIdxBeforeCW = band[bandIdx].bandwidthIdx;
		band[bandIdx].bandwidthIdx = 0;
	}
	else if (currentMode == CW && bwIdxBeforeCW >= 0)
	{
		band[bandIdx].bandwidthIdx = bwIdxBeforeCW;
		bwIdxBeforeCW = -1;
	}

	currentMode = newMode;

	band[bandIdx].currentFreq = currentFrequency;
	band[bandIdx].currentStepIdx = currentStepIdx;
	band[bandIdx].bandMODE = currentMode;                      // G8PTN: Added to support mode per band
	useBand();
}

void doMode(int8_t v)
{
	currentMode = band[bandIdx].bandMODE;               // G8PTN: Added to support mode per band

	if (currentMode != FM)                         // Nothing to do if FM mode
	{
		uint8_t pos = 0;
		while (pos < modeCycleLen - 1 && modeCycle[pos] != currentMode) pos++;
		pos = (v == -1) ? (pos + 1) % modeCycleLen : (pos + modeCycleLen - 1) % modeCycleLen;
		setMode(modeCycle[pos]);
		ui.setListPos(currentMode);
	}
	delay(MIN_ELAPSED_TIME); // waits a little more for releasing the button.
	elapsedCommand = millis();
}

/**
 * Applies an RX Mode profile (rx_profiles.h): switches the mode if the profile needs one, then
 * sets AGC/ATTN, AVC, SoftMute and bandwidth of the (new) current mode. LSB, USB and CW share
 * the SSB settings, so a CW profile also changes what SSB uses until another profile or a
 * manual change.
 */
void applyRxProfile(uint8_t idx)
{
	const RxProfile& p = rxProfiles[idx];

	if (!rxProfileFitsMode(p)) {
		if (p.mode == RXP_SSB) setMode(currentFrequency < 10000 ? LSB : USB);   // Amateur convention: LSB below 10 MHz
		else setMode(p.mode);
	}

	if (isSSB()) {
		SsbAgcIdx = rxProfileAgcIdx(p);
		SsbAvcIdx = p.avcMaxGain;
		SsbSoftMuteIdx = p.softMuteSSB;
		bwIdxSSB = p.bwSSB;
		band[bandIdx].bandwidthIdx = bwIdxSSB;
		applySsbBandwidth();
	}
	else {
		AmAgcIdx = rxProfileAgcIdx(p);
		AmAvcIdx = p.avcMaxGain;
		AmSoftMuteIdx = p.softMuteAM;
		bwIdxAM = p.bwAM;
		band[bandIdx].bandwidthIdx = bwIdxAM;
		rxWriteAmFilter(bandwidthAM[bwIdxAM].idx);
	}

	// v = 0: no incr/decr, just selects and sends the per mode values set above (only the changed ones reach the chip)
	doAgc(0);
	doSoftMute(0);
	doAvc(0);

	resetEepromDelay();
}

// RX Mode list (profile names), starting on the profile in use
void openRxMode()
{
	static char list[96];
	size_t len = 0;
	for (uint8_t i = 0; i < rxProfileCount; i++)
		len += snprintf(list + len, sizeof(list) - len, i ? "\n%s" : "%s", rxProfiles[i].name);

	int8_t p = findRxProfile();
	cmdRxMode = true;
	ui.setMenu(p < 0 ? 0 : p, list);
}

/**
 * Sets the audio volume
 */
void doVolume(int8_t v) {
	if (v == 1)
		rx.volumeUp();
	else
		rx.volumeDown();

	delay(MIN_ELAPSED_TIME); // waits a little more for releasing the button.
}

/**
 *  This function is called by the seek function process.  G8PTN: Added
 */
bool checkStopSeeking() {
	// Checks the seekStop flag
	return seekStop;  // returns true if the user rotates the encoder
}

/**
 *  This function is called by the seek function process.
 */
void showFrequencySeek(uint16_t freq)
{
	currentFrequency = freq;
}

/**
 *  Find a station. The direction is based on the last encoder move clockwise or counterclockwise
 */
void doSeek()
{
	if (isSSB()) return; // It does not work for SSB mode

	rx.seekStationProgress(showFrequencySeek, checkStopSeeking, seekDirection);   // G8PTN: Added checkStopSeeking
	currentFrequency = rx.getFrequency();

}

/**
 * Sets the Soft Mute Parameter
 */
void doSoftMute(int8_t v)
{
	// G8PTN: Modified to have separate SoftMute per mode (AM, SSB)
	// Only allow for AM and SSB modes
	if (currentMode != FM) {

		if (isSSB()) {
			if (v == 1)   SsbSoftMuteIdx++;
			else if (v == -1)  SsbSoftMuteIdx--;

			// Limit range
			if (SsbSoftMuteIdx < 0)
				SsbSoftMuteIdx = 32;
			else if (SsbSoftMuteIdx > 32)
				SsbSoftMuteIdx = 0;

			// Select
			softMuteMaxAttIdx = SsbSoftMuteIdx;
		}

		else {
			if (v == 1)   AmSoftMuteIdx++;
			else if (v == -1)  AmSoftMuteIdx--;

			// Limit range
			if (AmSoftMuteIdx < 0)
				AmSoftMuteIdx = 32;
			else if (AmSoftMuteIdx > 32)
				AmSoftMuteIdx = 0;

			// Select
			softMuteMaxAttIdx = AmSoftMuteIdx;
		}

		rxWriteSoftMute(softMuteMaxAttIdx);

		// Only call showSoftMute() if incr/decr action (allows the doSoftMute(0) to act as getSoftMute)
		//if (v != 0) showSoftMute();

		elapsedCommand = millis();
	}
}

/**
 *  Menu options selection
 */
void doMenu(int8_t v) {

	selectMenuList(v);

	menuIdx = ui.getListPos();
}

void selectMenuList(int8_t v) {

	if (v > 0) {
		ui.listPrev();
	}
	else {
		ui.listNext();
	}
}

/**
 * Return true if the current status is Menu command
 */
bool isMenuMode() {
	return (cmdMenu | cmdStep | cmdBandwidth | cmdAgc | cmdVolume | cmdSoftMuteMaxAtt | cmdMode | cmdBand | cmdCal | cmdAvc
		| cmdPresetGroup | cmdPresetType | cmdPresetStation | cmdRxMode);     // G8PTN: Added cmdBand, cmdCal, cmdBrt and cmdAvc
}


uint8_t getStrength() {
	if (currentMode != FM) {
		//dBuV to S point conversion HF
		if ((rssi >= 0) and (rssi <= 1)) 	return  1;  // S0
		if ((rssi > 1) and (rssi <= 2)) 	return  2;  // S1         // G8PTN: Corrected table
		if ((rssi > 2) and (rssi <= 3)) 	return  3;  // S2
		if ((rssi > 3) and (rssi <= 4)) 	return  4;  // S3
		if ((rssi > 4) and (rssi <= 10)) 	return  5;  // S4
		if ((rssi > 10) and (rssi <= 16)) 	return  6;  // S5
		if ((rssi > 16) and (rssi <= 22)) 	return  7;  // S6
		if ((rssi > 22) and (rssi <= 28)) 	return  8;  // S7
		if ((rssi > 28) and (rssi <= 34)) 	return  9;  // S8
		if ((rssi > 34) and (rssi <= 44)) 	return 10;  // S9
		if ((rssi > 44) and (rssi <= 54)) 	return 11;  // S9 +10
		if ((rssi > 54) and (rssi <= 64)) 	return 12;  // S9 +20
		if ((rssi > 64) and (rssi <= 74)) 	return 13;  // S9 +30
		if ((rssi > 74) and (rssi <= 84)) 	return 14;  // S9 +40
		if ((rssi > 84) and (rssi <= 94)) 	return 15;  // S9 +50
		if ((rssi > 94) and (rssi <= 95)) 	return 16;  // S9 +60
		if (rssi > 95)                   	return 17;  //>S9 +60
	}
	else
	{
		//dBuV to S point conversion FM
		if (rssi >= 0 and (rssi <= 1)) 	return  1;               // G8PTN: Corrected table
		if ((rssi > 1) and (rssi <= 2)) 	return  7;  // S6
		if ((rssi > 2) and (rssi <= 8)) 	return  8;  // S7
		if ((rssi > 8) and (rssi <= 14)) 	return  9;  // S8
		if ((rssi > 14) and (rssi <= 24)) 	return 10;  // S9
		if ((rssi > 24) and (rssi <= 34)) 	return 11;  // S9 +10
		if ((rssi > 34) and (rssi <= 44)) 	return 12;  // S9 +20
		if ((rssi > 44) and (rssi <= 54)) 	return 13;  // S9 +30
		if ((rssi > 54) and (rssi <= 64)) 	return 14;  // S9 +40
		if ((rssi > 64) and (rssi <= 74)) 	return 15;  // S9 +50
		if ((rssi > 74) and (rssi <= 76)) 	return 16;  // S9 +60
		if (rssi > 76)                   	return 17;  //>S9 +60
	}

	return 0;
}

void checkRDS()
{
	char* sName = nullptr;
	char* sInfo = nullptr;
	char* sTime = nullptr;

	rx.getRdsStatus();
	if (rx.getRdsReceived())
	{
		if (rx.getRdsSync() && rx.getRdsSyncFound())
		{
			//sName = rx.getRdsText2A();
			sName = rx.getRdsStationName();
			if (sName != nullptr) {
				stationName = sName;
			}
			//sInfo = rx.getRdsText0A();
			sInfo = rx.getRdsProgramInformation();
			if (sInfo != nullptr) {
				rdsMsg = sInfo;
			}
			sTime = rx.getRdsTime();
			if (sTime != nullptr) {
				rdsTime = sTime;
			}
		}
	}
}

/***************************************************************************************
** Description:   In SSB mode tuning uses VFO and BFO
**                - Algorithm from ATS-20_EX Goshante firmware
***************************************************************************************/
// Tuning algorithm

void updateBFO()
{
	// To move frequency forward, need to move the BFO backwards, so multiply by -1
	// In CW the receiver is tuned CW_TONE_HZ below the displayed frequency (USB), so a carrier on the
	// displayed frequency is heard as a CW_TONE_HZ beat note
	currentCAL = band[bandIdx].bandCAL;    // Select from table
	int16_t cwOffset = (currentMode == CW) ? CW_TONE_HZ : 0;
	rx.setSSBBfo((currentBFO + currentCAL - cwOffset) * -1);

}

// Clamp SSB tuning to band limits
bool clampSSBBand()
{
	uint16_t freq = currentFrequency + (currentBFO / 1000);

	// Special case to cover SSB frequency negative!
	bool SsbFreqNeg = false;
	if (currentFrequency & 0x8000)
		SsbFreqNeg = true;

	// Priority to minimum check to cover SSB frequency negative
	bool upd = false;
	if (freq < band[bandIdx].minimumFreq || SsbFreqNeg)
	{
		currentFrequency = band[bandIdx].maximumFreq;
		upd = true;
	}
	else if (freq > band[bandIdx].maximumFreq)
	{
		currentFrequency = band[bandIdx].minimumFreq;
		upd = true;
	}

	if (upd)
	{
		band[bandIdx].currentFreq = currentFrequency;    // Update band table currentFreq
		rx.setFrequency(currentFrequency);
		currentBFO = 0;
		updateBFO();
		return true;
	}

	return false;
}

void doFrequencyTuneSSB()
{
	//const int BFOMax = 16000;    G8PTN: Moved to a global variable
	int step = encoderCount == 1 ? getSteps() : getSteps() * -1;
	int newBFO = currentBFO + step;
	int redundant = 0;

	if (newBFO > BFOMax)
	{
		redundant = (newBFO / BFOMax) * BFOMax;
		currentFrequency += redundant / 1000;
		newBFO -= redundant;
	}
	else if (newBFO < -BFOMax)
	{
		redundant = ((abs(newBFO) / BFOMax) * BFOMax);
		currentFrequency -= redundant / 1000;
		newBFO += redundant;
	}

	currentBFO = newBFO;
	updateBFO();

	if (redundant != 0)

	{
		clampSSBBand();                                   // G8PTN: Added          
		rx.setFrequency(currentFrequency);
		//agcSetFunc(); //Re-apply to remove noize        // G8PTN: Commented out
		currentFrequency = rx.getFrequency();
		//band[bandIdx].currentFreq = currentFrequency;   // G8PTN: Commented out, covered below
	}

	band[bandIdx].currentFreq = currentFrequency + (currentBFO / 1000);     // Update band table currentFreq

}

void doCal(int16_t v) {
	currentCAL = band[bandIdx].bandCAL;    // Select from table
	if (v == 1) {
		currentCAL = currentCAL + 10;
		if (currentCAL > CALMax) currentCAL = CALMax;
	}

	else {
		currentCAL = currentCAL - 10;
		if (currentCAL < -CALMax) currentCAL = -CALMax;
	}
	band[bandIdx].bandCAL = currentCAL;    // Store to table

	// If in SSB mode set the SI4732/5 BFO value
	// This adjustments the BFO whilst in the calibration menu
	if (isSSB()) updateBFO();

	delay(MIN_ELAPSED_TIME); // waits a little more for releasing the button.
}

// Next AVC value in rxAvcSteps[] (wrapping around), or the same value clamped to 12..90 dB if v = 0.
// A value between steps (stored by an older firmware) moves to the nearest step in the turning direction.
int8_t stepAvc(int8_t avc, int16_t v) {
	if (v > 0) {
		for (uint8_t i = 0; i < rxAvcStepCount; i++)
			if (rxAvcSteps[i] > avc) return rxAvcSteps[i];
		return rxAvcSteps[0];
	}
	if (v < 0) {
		for (int8_t i = rxAvcStepCount - 1; i >= 0; i--)
			if (rxAvcSteps[i] < avc) return rxAvcSteps[i];
		return rxAvcSteps[rxAvcStepCount - 1];
	}
	return constrain(avc, 12, 90);
}

void doAvc(int16_t v) {
	// Only allow for AM and SSB modes
	if (currentMode != FM) {

		if (isSSB()) {
			SsbAvcIdx = stepAvc(SsbAvcIdx, v);
			currentAVC = SsbAvcIdx;
		}
		else {
			AmAvcIdx = stepAvc(AmAvcIdx, v);
			currentAVC = AmAvcIdx;
		}

		// Configure SI4732/5
		rxWriteAvc(currentAVC);

		// Only call showAvc() if incr/decr action (allows the doAvc(0) to act as getAvc)
		//if (v != 0) showAvc();
		delay(MIN_ELAPSED_TIME); // waits a little more for releasing the button.
	}
}

// -----------------------------------------------------------------------------------

void setup() {

	Serial.begin(115200);
	Serial.println("Starting...");
	Serial.println("SI4732/5 Radio v" + String(app_ver) + " by joaquim.org");

	hal_extcom_start();                    // Display VCOM inversion (started here, once FreeRTOS is running)

	encoder.setBoundaries(-1, 1, false);
	encoder.begin();

	pinMode(ROTARY_ENCODER_BUTTON_PIN, INPUT_PULLUP);

	ui.lcd()->drawXBM(0, 0, welcome_width, welcome_height, welcome_bits);
	ui.updateDisplay();

	Wire.begin(ESP32_I2C_SDA, ESP32_I2C_SCL);

	delay(300);

	// EEPROM
	// Note: Use EEPROM.begin(EEPROM_SIZE) before use and EEPROM.begin.end after use to free up memory and avoid memory leaks
	EEPROM.begin(EEPROM_SIZE);

	// Press and hold Encoder button to force an EEPROM reset
	// Indirectly forces the reset by setting app_id = 0 (Detectected in the subsequent check for app_id and app_ver)
	// Note: EEPROM reset is recommended after firmware updates

	if (digitalRead(ROTARY_ENCODER_BUTTON_PIN) == LOW)
	{
		EEPROM.write(eeprom_address, 0);
		EEPROM.commit();
		ui.showStatusScreen("EEPROM", "EEPROM Resetting...");
		ui.updateDisplay();
		delay(1000);
	}

	EEPROM.end();

	attachInterrupt(digitalPinToInterrupt(ROTARY_ENCODER_BUTTON_PIN), buttonISR, FALLING);

	// Check for SI4732 connected on I2C interface
	// If the SI4732 is not detected, then halt with no further processing
	rx.setI2CFastModeCustom(100000);

	int16_t si4735Addr = rx.getDeviceI2CAddress(RESET_PIN); // Looks for the I2C bus address and set it.  Returns 0 if error

	if (si4735Addr == 0) {
		ui.showStatusScreen("ERROR", "RADIO hardware not found !");
		ui.updateDisplay();
		while (1);
	}

	rx.setup(RESET_PIN, MW_BAND_TYPE);

	cleanBfoRdsInfo();

	delay(300);

	// Perform check against app_id and app_ver
	uint8_t  id_read;
	uint16_t ver_read;

	EEPROM.begin(EEPROM_SIZE);
	id_read = EEPROM.read(eeprom_address);
	ver_read = EEPROM.read(eeprom_ver_address) << 8;
	ver_read |= EEPROM.read(eeprom_ver_address + 1);
	EEPROM.end();

	if ((id_read == app_id) && (ver_read == app_ver)) {
		readAllReceiverInformation();                        // Load EEPROM values
	}
	else {
		saveAllReceiverInformation();                        // Set EEPROM to defaults
		rx.setVolume(volume);                                // Set initial volume after EEPROM reset
	}

	// ** SI4732 STARTUP **
	// Uses values from EEPROM (Last stored or defaults after EEPROM reset) 
	useBand();

	sampling_period_us = round(1000000 * (1.0 / SAMPLING_FREQ));

}

// -----------------------------------------------------------------------------------

/**
 * Starts the MENU action process
 */
void doCurrentMenuCmd() {
	disableCommands();
	switch (currentMenuCmd) {
	case VOLUME:                   // VOLUME
		if (muted) {
			rx.setVolume(mute_vol_val);
			muted = false;
		}
		cmdVolume = true;
		break;
	case STEP:                      // STEP
		cmdStep = true;
		if (currentMode == FM) {
			ui.setMenu(currentStepIdx, FmStepStr);
		}
		else if (isSSB()) {
			ui.setMenu(currentStepIdx, AmSsbStepStr);
		}
		else {
			ui.setMenu(currentStepIdx, AmStepStr);
		}
		break;
	case MODE:                      // MODE
		cmdMode = true;
		ui.setMenu(currentMode, modeStr);
		break;
	case RXMODE:                    // RX MODE
		if (currentMode != FM) {
			openRxMode();
		}
		else {
			showInfoMsg("Not available in FM mode !");
		}
		break;
	case BW:                        // BW
		cmdBandwidth = true;
		if (currentMode == FM) {
			ui.setMenu(bwIdxFM, bandwidthFMStr);
		}
		else if (isSSB()) {
			ui.setMenu(bwIdxSSB, bandwidthSSBStr);
		}
		else {
			ui.setMenu(bwIdxAM, bandwidthAMStr);
		}
		break;
	case AGC_ATT:                   // AGC/ATT
		cmdAgc = true;
		break;
	case SOFTMUTE:                  // SOFTMUTE
		if (currentMode != FM) {
			cmdSoftMuteMaxAtt = true;
		}
		else {
			showInfoMsg("Not available in FM mode !");
		}
		break;
	case SEEKUP:                    // SEEKUP
		seekStop = false;             // G8PTN: Flag is set by rotary encoder and cleared on seek entry
		seekDirection = 1;
		doSeek();
		break;
	case SEEKDOWN:                  // SEEKDOWN
		seekStop = false;             // G8PTN: Flag is set by rotary encoder and cleared on seek entry
		seekDirection = 0;
		doSeek();
		break;
	case BAND:                      // BAND
		cmdBand = true;
		ui.setMenu(bandIdx, bandStr);
		break;
	case PRESETS:                   // PRESETS
		openPresets();
		break;
	case MUTE:                      // MUTE
		muted = !muted;
		if (muted)
		{
			mute_vol_val = rx.getVolume();
			rx.setVolume(0);
		}
		else rx.setVolume(mute_vol_val);
		break;

		// G8PTN: Added
	case CALIBRATION:               // CALIBRATION
		if (isSSB()) {
			cmdCal = true;
			currentCAL = band[bandIdx].bandCAL;
		}
		else {
			showInfoMsg("Only available in SSB mode !");
		}
		break;
		// G8PTN: Added
	case AVC:                       // AVC
		if (currentMode != FM) {
			cmdAvc = true;
		}
		else {
			showInfoMsg("Not available in FM mode !");
		}
		break;

	case DECODECW:
		if (isSSB()) {
			decodeCW = !decodeCW;
		}
		else {
			showInfoMsg("Only available in SSB mode !");
		}
		break;

	case SPECTRUM:
		spectrumOn = !spectrumOn;
		showInfoMsg(spectrumOn ? "Spectrum ON" : "Spectrum OFF");
		resetEepromDelay();
		break;

	default:
		break;
	}
	currentMenuCmd = -1;
	elapsedCommand = millis();
}

/**
 * Frequency direct edit: long press enters, encoder changes the selected digit,
 * short press moves to the next digit, another long press applies and exits.
 */
void startFreqEdit() {
	disableCommands();

	// Edit in kHz for AM/SSB (BFO folded in) and in 10 kHz units for FM, as stored in band[]
	editFrequency = isSSB() ? currentFrequency + (currentBFO / 1000) : currentFrequency;
	if (editFrequency < band[bandIdx].minimumFreq) editFrequency = band[bandIdx].minimumFreq;
	if (editFrequency > band[bandIdx].maximumFreq) editFrequency = band[bandIdx].maximumFreq;

	// Only the digits that can change within the band limits are editable
	editNumDigits = 0;
	for (uint16_t f = band[bandIdx].maximumFreq; f > 0; f /= 10) editNumDigits++;

	editDigit = editNumDigits - 1;      // Start on the most significant digit
	cmdFreqEdit = true;
}

void doFreqEdit(int8_t v) {
	int32_t delta = 1;
	for (uint8_t i = 0; i < editDigit; i++) delta *= 10;

	// Keep the edited frequency inside the band (Whole SW covers the full SW range)
	int32_t f = (int32_t)editFrequency + (v * delta);
	if (f < band[bandIdx].minimumFreq) f = band[bandIdx].minimumFreq;
	if (f > band[bandIdx].maximumFreq) f = band[bandIdx].maximumFreq;
	editFrequency = f;

	tuneEditFrequency();                // Tune live while editing
}

void nextFreqEditDigit() {
	editDigit = (editDigit == 0) ? editNumDigits - 1 : editDigit - 1;
}

void commitFreqEdit() {
	cmdFreqEdit = false;
}

void tuneEditFrequency() {
	if (isSSB()) {
		currentFrequency = editFrequency;
		currentBFO = 0;
		rx.setFrequency(currentFrequency);
		updateBFO();
		currentFrequency = rx.getFrequency();
	}
	else {
		rx.setFrequency(editFrequency);
		if (currentMode == FM) cleanBfoRdsInfo();
		currentFrequency = rx.getFrequency();
	}
	band[bandIdx].currentFreq = currentFrequency;
	resetEepromDelay();
}

void doEncoderAction() {
	if (cmdFreqEdit)
		doFreqEdit(encoderCount);
	// G8PTN: The manual BFO adjusment is not required with the doFrequencyTuneSSB method, but leave for debug
	else if (bfoOn & isSSB())
	{
		currentBFO = (encoderCount == 1) ? (currentBFO + currentBFOStep) : (currentBFO - currentBFOStep);
		// G8PTN: Clamp range to +/- BFOMax (as per doFrequencyTuneSSB)
		if (currentBFO > BFOMax) currentBFO = BFOMax;
		if (currentBFO < -BFOMax) currentBFO = -BFOMax;
		band[bandIdx].currentFreq = currentFrequency + (currentBFO / 1000);     // G8PTN; Calculate frequency value to store in EEPROM    
		updateBFO();
	}
	else if (cmdMenu)
		doMenu(encoderCount);
	else if (cmdPresetGroup || cmdPresetType || cmdPresetStation || cmdRxMode)
		selectMenuList(encoderCount);
	else if (cmdMode)
		doMode(encoderCount);
	else if (cmdStep)
		doStep(encoderCount);
	else if (cmdAgc)
		doAgc(encoderCount);
	else if (cmdBandwidth)
		doBandwidth(encoderCount);
	else if (cmdVolume)
		doVolume(encoderCount);
	else if (cmdSoftMuteMaxAtt)
		doSoftMute(encoderCount);
	else if (cmdBand)
		setBand(encoderCount);

	// G8PTN: Added commands
	else if (cmdCal)
		doCal(encoderCount);
	else if (cmdAvc)
		doAvc(encoderCount);

	// G8PTN: Added SSB tuning
	else if (isSSB()) {

		doFrequencyTuneSSB();
		currentFrequency = rx.getFrequency();
	}
	else {

		// G8PTN: Used in place of rx.frequencyUp() and rx.frequencyDown()
		if (currentMode == FM)
			currentFrequency += tabFmStep[currentStepIdx] * encoderCount;       // FM Up/Down
		else
			currentFrequency += tabAmStep[currentStepIdx] * encoderCount;       // AM Up/Down

		// Band limit checking
		uint16_t bMin = band[bandIdx].minimumFreq;                            // Assign lower band limit
		uint16_t bMax = band[bandIdx].maximumFreq;                            // Assign upper band limit

		// Special case to cover AM frequency negative!
		bool AmFreqNeg = false;
		if ((currentMode == AM) && (currentFrequency & 0x8000))
			AmFreqNeg = true;

		// Priority to minimum check to cover AM frequency negative
		if ((currentFrequency < bMin) || AmFreqNeg)
			currentFrequency = bMax;                                           // Lower band limit or AM frequency negative
		else if (currentFrequency > bMax)
			currentFrequency = bMin;                                           // Upper band limit

		rx.setFrequency(currentFrequency);                                   // Set new frequency

		if (currentMode == FM) cleanBfoRdsInfo();
		// Show the current frequency only if it has changed
		currentFrequency = rx.getFrequency();
		band[bandIdx].currentFreq = currentFrequency;            // G8PTN: Added to ensure update of currentFreq in table for AM/FM
	}

	encoderCount = 0;
	resetEepromDelay();
	delay(MIN_ELAPSED_TIME);
	elapsedCommand = millis();
}

void doButtonAction() {
	//while (digitalRead(ENCODER_PUSH_BUTTON) == LOW) { }
	countClick++;
	if (cmdFreqEdit)
	{
		nextFreqEditDigit();
	}
	else if (cmdMenu)
	{
		currentMenuCmd = menuIdx;
		doCurrentMenuCmd();
	}
	else if (cmdPresetGroup || cmdPresetType || cmdPresetStation)
	{
		presetMenuSelect();
	}
	else if (cmdRxMode)
	{
		applyRxProfile(ui.getListPos());
		showInfoMsg(rxProfiles[ui.getListPos()].name);
		disableCommands();
	}
	//else if (countClick == 1)
	else if (countClick >= 1)                   // G8PTN: All actions now done on single press
	{
		if (isMenuMode())
		{
			disableCommands();
		}
		else if (bfoOn) {
			bfoOn = false;
		}
		else
		{
			cmdMenu = !cmdMenu;
			if (menuIdx == EXIT) menuIdx = STEP;     // Reopens on the last used option, except Exit
			currentMenuCmd = menuIdx;
			ui.setMenu(menuIdx, MenuStr, mainMenuValue);
		}
	}
	else                                       // G8PTN: Not used
	{ // GO to MENU if more than one click in less than 1/2 seconds.
		cmdMenu = !cmdMenu;
	}
	delay(MIN_ELAPSED_TIME);
	elapsedCommand = millis();
}

void doLongPressAction() {
	if (cmdFreqEdit)
		commitFreqEdit();
	else
		startFreqEdit();
	elapsedCommand = millis();
}

/**
 * Tracks the press latched by the ISR: fires the long press while the button is still held,
 * or the short press on release.
 */
void checkButton() {
	if (!buttonDown) return;

	uint32_t held = millis() - buttonDownTime;
	if (digitalRead(ROTARY_ENCODER_BUTTON_PIN) == HIGH) {
		if (held < BUTTON_MIN_PRESS_MS) return;
		buttonDown = false;
		lastButtonIrq = millis();          // Debounce the release bounce
		infoShow = false;
		if (!longPressHandled) doButtonAction();
		longPressHandled = false;
	}
	else if (!longPressHandled && held >= BUTTON_LONG_PRESS_MS) {
		longPressHandled = true;
		infoShow = false;
		doLongPressAction();
	}
}


void drawMenu() {
	if (!isMenuMode()) return;

	char value[12];

	if (cmdMenu || cmdMode || cmdStep || cmdBandwidth || cmdBand || cmdRxMode) {
		const char* title = cmdMenu ? "Menu" : cmdMode ? "Mode" : cmdStep ? "Step" : cmdBandwidth ? "Bandwidth"
			: cmdRxMode ? "RX Mode" : "Band";
		ui.drawMenuPanel(title, ui.getMenuHeight(), true);
		ui.drawMenu();
	}
	else if (cmdPresetGroup || cmdPresetType || cmdPresetStation) {
		const char* title = cmdPresetGroup ? "Presets"
			: (cmdPresetType || presetTypeCount == 1) ? presetGroupNames[presetGroup] : presetTypeNames[presetType];
		ui.drawMenuPanel(title, ui.getMenuHeight(), true);
		ui.drawMenu();
	}
	else if (cmdAgc) {
		int8_t maxAtt = (currentMode == FM) ? 26 : 36;
		if (agcIdx == 0) {
			ui.drawValuePanel("AGC/ATTN", Font::FONT_B32_TF, "AGC ON", nullptr, 0, 0, maxAtt, false);
		}
		else {
			snprintf(value, sizeof(value), "%d", agcNdx);
			ui.drawValuePanel("AGC/ATTN", Font::FONT_56_NF, value, "ATT", agcNdx, 0, maxAtt, false);
		}
	}
	else if (cmdVolume) {
		uint8_t vol = rx.getVolume();
		snprintf(value, sizeof(value), "%ld", map(vol, 0, 63, 0, 100));
		ui.drawValuePanel("Volume", Font::FONT_56_NF, value, "%", vol, 0, 63, false);
	}
	else if (cmdSoftMuteMaxAtt) {
		snprintf(value, sizeof(value), "%d", softMuteMaxAttIdx);
		ui.drawValuePanel("SoftMute", Font::FONT_56_NF, value, "dB", softMuteMaxAttIdx, 0, 32, false);
	}
	else if (cmdCal) {
		snprintf(value, sizeof(value), "%+d", currentCAL);
		ui.drawValuePanel("Calibration", Font::FONT_56_NF, value, "Hz", currentCAL, -CALMax, CALMax, true);
	}
	else if (cmdAvc) {
		snprintf(value, sizeof(value), "%d", currentAVC);
		ui.drawValuePanel("AVC", Font::FONT_56_NF, value, "dB", currentAVC, 12, 90, false);
	}
}

void loop() {
	if (spectrumOn || decodeCW)
		getAudioData();

	// Check if the encoder has moved.
	if (encoder.encoderChanged()) {
		encoderCount = encoder.getEncoderValue();
		encoder.setEncoderValue(0);
	}

	if (encoderCount != 0)
	{
		infoShow = false;
		doEncoderAction();
	}

	checkButton();

	// Disable commands control
	if ((millis() - elapsedCommand) > ELAPSED_COMMAND)
	{
		if (isSSB())
		{
			bfoOn = false;
			disableCommands();
		}
		else if (isMenuMode() || cmdFreqEdit) {
			disableCommands();
		}
		if (infoShow) {
			infoShow = false;
		}

		elapsedCommand = millis();
	}

	if ((millis() - elapsedClick) > ELAPSED_CLICK)
	{
		countClick = 0;
		elapsedClick = millis();
	}


	// Show RSSI status only if this condition has changed
	if ((millis() - elapsedRSSI) > MIN_ELAPSED_RSSI_TIME)
	{

		rx.getCurrentReceivedSignalQuality();
		snr = rx.getCurrentSNR();
		int aux = rx.getCurrentRSSI();

		//if (rssi != aux && !isMenuMode())
		if (rssi != aux)                            // G8PTN: Based on 1.2s update, always allow S-Meter
		{
			rssi = aux;
		}
		elapsedRSSI = millis();
	}

	if ((millis() - lastRDSCheck) > RDS_CHECK_TIME) {
		if ((currentMode == FM) and (snr >= 12)) checkRDS();
		lastRDSCheck = millis();
	}

	// Show the current frequency only if it has changed
	if (itIsTimeToSave)
	{
		if ((millis() - storeTime) > STORE_TIME)
		{
			saveAllReceiverInformation();
			storeTime = millis();
			itIsTimeToSave = false;
		}
	}

	// Periodically refresh the main screen
	// This covers the case where there is nothing else triggering a refresh
	if ((millis() - background_timer) > BACKGROUND_REFRESH_TIME) {
		background_timer = millis();
		showStatus();
		drawMainVFO();

		if (spectrumOn && !isMenuMode()) {
			drawSpectrum(265, 120);
		}

		drawMenu();
		if (infoShow) {
			ui.showStatusScreen("", infoMessage);
		}
		ui.updateDisplay();
	}

}
